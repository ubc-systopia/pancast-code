## CMakeLists.txt
```
# Find Zephyr. This also loads Zephyr's build system.
cmake_minimum_required(VERSION 3.13.1)
find_package(Zephyr)
project(pancase_dongle)


# Add your source file to the "app" target. This must come after
# find_package(Zephyr) which defines the target.
target_sources(app PRIVATE src/dongle.c)
target_sources(app PRIVATE src/storage.c)
target_sources(app PRIVATE src/encounter.c)
```

## prj.conf
```kconfig
CONFIG_BT=y
CONFIG_BT_CENTRAL=y
CONFIG_BT_DEBUG_LOG=y
CONFIG_BT_DEVICE_NAME="PanCast Test Dongle"
CONFIG_FLASH=y
CONFIG_BT_PERIPHERAL=y
CONFIG_BT_SMP=y
CONFIG_BT_BAS=y
CONFIG_BT_GATT_CLIENT=y
```

## src/main.c
```c
//
// Dongle Application for PanCast Beacon logging
// Early version based on the bluetooth-central example from Zephyr
// This acts as a passive scanner that makes no connections and
// instead interprets and logs payload data from PanCast beacons.
//

#include <zephyr.h>
#include <sys/printk.h>
#include <sys/util.h>

#include <bluetooth/bluetooth.h>
#include <bluetooth/hci.h>
#include <bluetooth/conn.h>
#include <bluetooth/uuid.h>
#include <bluetooth/gatt.h>
#include "../../common/src/pancast.h"
#include "../../common/src/util.h"

#define LOG_LEVEL__INFO
#include "../../common/src/log.h"

// number of distinct broadcast ids to keep track of at one time
#define DONGLE_MAX_BC_TRACKED 16

static int decode_payload(uint8_t *data)
{
    data[0] = data[1];
    data[1] = data[MAX_BROADCAST_SIZE - 1];
    return 0;
}

// matches the schema defined by encode
static int decode_encounter(encounter_broadcast_t *dat, encounter_broadcast_raw_t *raw)
{
    uint8_t *src = (uint8_t*) raw;
    size_t pos = 0;
#define link(dst, type) (dst = (type*) (src + pos)); pos += sizeof(type)
    link(dat->t, beacon_timer_t);
	link(dat->b, beacon_id_t);
    link(dat->loc, beacon_location_id_t);
	link(dat->eph, beacon_eph_id_t);
#undef link
    return 0;
}

// compares two ephemeral ids
static int ephcmp(beacon_eph_id_t *a, beacon_eph_id_t *b)
{
#define A (a -> bytes)
#define B (b -> bytes)
	for (int i = 0; i < BEACON_EPH_ID_HASH_LEN; i++)
		if (A[i] != B[i])
				return 1;
#undef B
#undef A
	return 0;
}

// GLOBAL DATA
struct k_mutex dongle_mu;

#define LOCK k_mutex_lock(&dongle_mu, K_FOREVER);
#define UNLOCK k_mutex_unlock(&dongle_mu);
#define safely(e) LOCK e; UNLOCK

dongle_timer_t dongle_time;								// main dongle timer
beacon_eph_id_t cur_id[DONGLE_MAX_BC_TRACKED];			// currently observed ephemeral id
dongle_timer_t obs_time[DONGLE_MAX_BC_TRACKED];			// time of last new id observation

typedef size_t id_idx_t;
id_idx_t cur_id_idx = 0;

void dongle_time_set(dongle_timer_t *t)
{
	safely(dongle_time = *t);
}

void dongle_time_add(uint32_t *a)
{
	safely(dongle_time += *a);
}

void dongle_time_print()
{
	dongle_timer_t tmp;
	safely(tmp = dongle_time);
	log_debugf("dongle_time = %u\n", tmp);
}

void dongle_time_cpy(dongle_timer_t *t)
{
	dongle_timer_t tmp;
	safely(tmp = dongle_time);
	*t = tmp;
}

static void dongle_log(const bt_addr_le_t *addr, int8_t rssi, uint8_t type,
			 struct net_buf_simple *ad)
{
	char addr_str[BT_ADDR_LE_STR_LEN];
	bt_addr_le_to_str(addr, addr_str, sizeof(addr_str));
// Filter mis-sized packets
    if (ad -> len != ENCOUNTER_BROADCAST_SIZE + 1) {
        return;
    }
    decode_payload(ad -> data);
    encounter_broadcast_t en;
    decode_encounter(&en, (encounter_broadcast_raw_t*) ad -> data);
// the following alters dongle state, so the lock is obtained
	LOCK
// determine which tracked id, if any, is a match
	id_idx_t i = DONGLE_MAX_BC_TRACKED;
	for (id_idx_t j = 0; j < DONGLE_MAX_BC_TRACKED; j++) {
		if (!ephcmp(en.eph, &cur_id[j])) {
			i = j;
		}
	}
	if (i == DONGLE_MAX_BC_TRACKED) {
// if no match was found, start tracking the new id, replacing the oldest one
// currently tracked
		i = cur_id_idx;
		log_infof("new ephemeral id observed (beacon=%u), tracking at index %d\n", *en.b, i);
		info_bytes(en.eph -> bytes, BEACON_EPH_ID_HASH_LEN, "eph_id");
		cur_id_idx = (cur_id_idx + 1) % DONGLE_MAX_BC_TRACKED;
		memcpy(&cur_id[i], en.eph -> bytes, BEACON_EPH_ID_HASH_LEN);
		obs_time[i] = dongle_time;
	} else {
		log_debugf("id match at index %d\n", i);
// when a matching ephemeral id is observed
// check conditions for a valid encounter
		dongle_timer_t dur = dongle_time - obs_time[i];
		log_debugf("observed for %u time units\n", dur);
		if (dur >= DONGLE_ENCOUNTER_MIN_TIME) {
// when a valid encounter is detected
// log the encounter
			log_infof("Beacon Encounter (id=%u, t_b=%u, t_d=%u, dev=%s)\n", *en.b, *en.t, dongle_time, addr_str);
// reset the observation time
			obs_time[i] = dongle_time;
		}
	}
	UNLOCK
}

static void dongle_scan(void)
{
// Initialization
// TODO: flash load

	dongle_timer_t t_init = 0; 									// Initial time

	k_mutex_init(&dongle_mu);

// Scan Start
	int err = err = bt_le_scan_start(BT_LE_SCAN_PARAM(
		BT_LE_SCAN_TYPE_PASSIVE,    // passive scan
		BT_LE_SCAN_OPT_NONE,        // no options; in particular, allow duplicates
		BT_GAP_SCAN_FAST_INTERVAL,  // interval
		BT_GAP_SCAN_FAST_WINDOW     // window
	), dongle_log);
	if (err) {
		log_errorf("Scanning failed to start (err %d)\n", err);
		return;
	} else {
		log_debug("Scanning successfully started\n");
	}

// Dongle Loop
// timing and control logic is largely the same as the beacon
// application. The main difference is that scanning does not
// require restart for a new epoch.

	dongle_time_set(&t_init);
	dongle_epoch_counter_t epoch = 0;

	struct k_timer kernel_time;
	k_timer_init(&kernel_time, NULL, NULL);

// Timer zero point
#define DUR K_MSEC(DONGLE_TIMER_RESOLUTION)
	k_timer_start(&kernel_time, DUR, DUR);
#undef DUR
	uint32_t timer_status = 0;

	while (!err) {
// get most updated time
		timer_status = k_timer_status_sync(&kernel_time);
		timer_status += k_timer_status_get(&kernel_time);
		dongle_time_add(&timer_status);
// update epoch
		static dongle_epoch_counter_t old_epoch;
		old_epoch = epoch;
		epoch = epoch_i(dongle_time, t_init);
		if (epoch != old_epoch) {
			log_infof("EPOCH STARTED: %u\n", epoch);
			// TODO: log time to flash
		}
		log_debugf("dongle timer: %u\n", dongle_time);

	}
}


void main(void)
{
	log_infof("Starting %s on %s\n", CONFIG_BT_DEVICE_NAME, CONFIG_BOARD);

	int err;

	err = bt_enable(NULL);
	if (err) {
		log_errorf("Bluetooth init failed (err %d)\n", err);
		return;
	}

	log_info("Bluetooth initialized\n");

	dongle_scan();
}
```

## src/access.c
```c
#include "./access.h"

#include <bluetooth/conn.h>
#include <bluetooth/gatt.h>

#include "./encounter.h"
#include "./storage.h"

#define LOG_LEVEL__INFO
#include "../../common/src/log.h"
#include "../../common/src/util.h"

// Memory
struct k_mutex state_mu;
interact_state state;
uint8_t dongle_state;
enctr_entry_counter_t num_recs;
enctr_entry_counter_t next_rec = 0;
dongle_encounter_entry send_en;

static const struct bt_data ad[] = {
    BT_DATA_BYTES(BT_DATA_UUID128_ALL,
                  DONGLE_SERVICE_UUID)};

// STATES
#define DONGLE_UPLOAD_STATE_LOCKED 0x01
#define DONGLE_UPLOAD_STATE_UNLOCKED 0x02
#define DONGLE_UPLOAD_STATE_SEND_DATA_0 0x03
#define DONGLE_UPLOAD_STATE_SEND_DATA_1 0x04
#define DONGLE_UPLOAD_STATE_SEND_DATA_2 0x05
#define DONGLE_UPLOAD_STATE_SEND_DATA_3 0x06
#define DONGLE_UPLOAD_STATE_SEND_DATA_4 0x07

struct bt_conn *terminal_conn = NULL;
static struct bt_uuid_128 SERVICE_UUID = BT_UUID_INIT_128(DONGLE_SERVICE_UUID);
static struct bt_uuid_128 CHARACTERISTIC_UUID = BT_UUID_INIT_128(DONGLE_CHARACTERISTIC_UUID);
static struct bt_uuid_128 uuid = BT_UUID_INIT_128(0);
static struct bt_gatt_discover_params discover_params;
static struct bt_gatt_subscribe_params subscribe_params;

BT_GATT_SERVICE_DEFINE(dongle_service,
                       // 0. Primary Service Attribute
                       BT_GATT_PRIMARY_SERVICE(BT_UUID_DECLARE_128(DONGLE_SERVICE_UUID)),
                       // 1. Interaction Data
                       BT_GATT_CHARACTERISTIC(BT_UUID_DECLARE_128(DONGLE_CHARACTERISTIC_UUID), BT_GATT_CHRC_NOTIFY | BT_GATT_CHRC_WRITE, (BT_GATT_PERM_READ | BT_GATT_PERM_WRITE), NULL, NULL, &state),
                       // 2. CCC
                       BT_GATT_CCC(NULL, BT_GATT_PERM_READ | BT_GATT_PERM_WRITE),
                       //
);

static uint8_t _notify_(struct bt_conn *conn,
                        struct bt_gatt_subscribe_params *params,
                        const void *data, uint16_t length)
{
    if (!data)
    {
        log_info("[UNSUBSCRIBED]\n");
        params->value_handle = 0U;
        return BT_GATT_ITER_STOP;
    }

    log_debugf("[NOTIFICATION] data length %u\n", length);
    print_bytes(data, length, "Data");

    k_mutex_lock(&state_mu, K_FOREVER);
    memcpy(&state, data, sizeof(interact_state));
    k_mutex_unlock(&state_mu);

    interact_update();

    return BT_GATT_ITER_CONTINUE;
}

static uint8_t _discover_(struct bt_conn *conn,
                          const struct bt_gatt_attr *attr,
                          struct bt_gatt_discover_params *params)
{
    int err;

    if (!attr)
    {
        printk("Discover complete\n");
        (void)memset(params, 0, sizeof(*params));
        return BT_GATT_ITER_STOP;
    }

    log_debugf("[ATTRIBUTE] handle %u\n", attr->handle);

    if (!bt_uuid_cmp(discover_params.uuid, BT_UUID_DECLARE_128(DONGLE_SERVICE_UUID)))
    {
        uuid = CHARACTERISTIC_UUID;
        discover_params.uuid = &uuid.uuid;
        discover_params.start_handle = attr->handle + 1;
        discover_params.type = BT_GATT_DISCOVER_CHARACTERISTIC;

        err = bt_gatt_discover(conn, &discover_params);
        if (err)
        {
            log_errorf("Characteristic Discover failed (err %d)\n", err);
        }
    }
    else if (!bt_uuid_cmp(discover_params.uuid,
                          BT_UUID_DECLARE_128(DONGLE_CHARACTERISTIC_UUID)))
    {
        memcpy(&uuid, BT_UUID_GATT_CCC, sizeof(uuid));
        discover_params.uuid = &uuid.uuid;
        discover_params.start_handle = attr->handle + 2;
        discover_params.type = BT_GATT_DISCOVER_DESCRIPTOR;
        subscribe_params.value_handle = bt_gatt_attr_value_handle(attr);

        err = bt_gatt_discover(conn, &discover_params);
        if (err)
        {
            log_errorf("CCC Discover failed (err %d)\n", err);
        }
    }
    else
    {
        subscribe_params.notify = _notify_;
        subscribe_params.value = BT_GATT_CCC_NOTIFY;
        subscribe_params.ccc_handle = attr->handle;

        err = bt_gatt_subscribe(conn, &subscribe_params);
        if (err && err != -EALREADY)
        {
            log_errorf("Subscribe failed (err %d)\n", err);
        }
        else
        {
            log_info("[SUBSCRIBED]\n");
        }

        return BT_GATT_ITER_STOP;
    }

    return BT_GATT_ITER_STOP;
}

void interact_update()
{
    k_mutex_lock(&state_mu, K_FOREVER);
    switch (dongle_state)
    {
    case DONGLE_UPLOAD_STATE_LOCKED:
        log_debug("Dongle is locked\n");
        if (state.flags == DONGLE_UPLOAD_DATA_TYPE_ACK_NUM_RECS)
        {
            log_debug("Ack for num recs received\n");
            break;
        }
        if (state.flags != DONGLE_UPLOAD_DATA_TYPE_OTP)
        {
            break;
        }
        log_debug("Checking code\n");
        dongle_lock();
        dongle_storage *storage = get_dongle_storage();
        int otp_idx = dongle_storage_match_otp(storage,
                                               *((dongle_otp_val *)state.otp.val));
        dongle_unlock();
        if (otp_idx > 0)
        {
            log_debug("Code checks out\n");
            dongle_lock();
            num_recs = dongle_storage_num_encounters(storage);
            if (num_recs == 0)
            {
                log_debug("No records, re-locking\n");
            }
            else
            {
                dongle_state = DONGLE_UPLOAD_STATE_UNLOCKED;
            }
            state.flags = DONGLE_UPLOAD_DATA_TYPE_NUM_RECS;
            memcpy(state.num_recs.val, &num_recs, sizeof(enctr_entry_counter_t));
            dongle_unlock();
            peer_update();
        }
        else
        {
            log_debug("bad code\n");
        }
        break;
    case DONGLE_UPLOAD_STATE_UNLOCKED:
    case DONGLE_UPLOAD_STATE_SEND_DATA_4:
        if (state.flags != DONGLE_UPLOAD_DATA_TYPE_ACK_NUM_RECS && state.flags != DONGLE_UPLOAD_DATA_TYPE_ACK_DATA_4)
        {
            break;
        }
        else if (state.flags == DONGLE_UPLOAD_DATA_TYPE_ACK_NUM_RECS)
        {
            log_debug("Ack for num recs received\n");
            log_info("Sending records...\n");
        }
        if (state.flags == DONGLE_UPLOAD_DATA_TYPE_ACK_DATA_4)
        {
            log_debug("Ack for d4 received\n");
            next_rec++;
        }

        if (next_rec >= num_recs)
        {
            log_info("All records sent\n");
            dongle_state = DONGLE_UPLOAD_STATE_LOCKED;
            next_rec = 0;
            break;
        }

        dongle_state = DONGLE_UPLOAD_STATE_SEND_DATA_0;

        // load next encounter
        dongle_storage_load_single_encounter(get_dongle_storage(), next_rec, &send_en);
        //_display_encounter_(&send_en);

        state.flags = DONGLE_UPLOAD_DATA_TYPE_DATA_0;
        memcpy(state.data.bytes, &send_en.beacon_id, sizeof(beacon_id_t));
        peer_update();
        break;
    case DONGLE_UPLOAD_STATE_SEND_DATA_0:
        if (state.flags != DONGLE_UPLOAD_DATA_TYPE_ACK_DATA_0)
        {
            break;
        }
        log_debug("Ack for d0 received\n");
        dongle_state = DONGLE_UPLOAD_STATE_SEND_DATA_1;

        state.flags = DONGLE_UPLOAD_DATA_TYPE_DATA_1;
        memcpy(state.data.bytes, &send_en.beacon_time, sizeof(beacon_timer_t));
        peer_update();
        break;
    case DONGLE_UPLOAD_STATE_SEND_DATA_1:
        if (state.flags != DONGLE_UPLOAD_DATA_TYPE_ACK_DATA_1)
        {
            break;
        }
        log_debug("Ack for d1 received\n");
        dongle_state = DONGLE_UPLOAD_STATE_SEND_DATA_2;

        state.flags = DONGLE_UPLOAD_DATA_TYPE_DATA_2;
        memcpy(state.data.bytes, &send_en.dongle_time, sizeof(dongle_timer_t));
        peer_update();
        break;
    case DONGLE_UPLOAD_STATE_SEND_DATA_2:
        if (state.flags != DONGLE_UPLOAD_DATA_TYPE_ACK_DATA_2)
        {
            break;
        }
        log_debug("Ack for d2 received\n");
        dongle_state = DONGLE_UPLOAD_STATE_SEND_DATA_3;

        state.flags = DONGLE_UPLOAD_DATA_TYPE_DATA_3;
        memcpy(state.data.bytes, send_en.eph_id.bytes, BEACON_EPH_ID_SIZE);
        peer_update();
        break;
    case DONGLE_UPLOAD_STATE_SEND_DATA_3:
        if (state.flags != DONGLE_UPLOAD_DATA_TYPE_ACK_DATA_3)
        {
            break;
        }
        log_debug("Ack for d3 received\n");
        dongle_state = DONGLE_UPLOAD_STATE_SEND_DATA_4;

        state.flags = DONGLE_UPLOAD_DATA_TYPE_DATA_4;
        memcpy(state.data.bytes, &send_en.location_id, sizeof(beacon_location_id_t));
        peer_update();
        break;
    default:
        log_errorf("No match for state! (%d)\n", dongle_state);
    }
    k_mutex_unlock(&state_mu);
}

void peer_update()
{
    k_mutex_lock(&state_mu, K_FOREVER);
    bt_gatt_notify(NULL, &dongle_service.attrs[1], &state, sizeof(interact_state));
    k_mutex_unlock(&state_mu);
}

static void _peer_connected_(struct bt_conn *conn, uint8_t err)
{
    if (err)
    {
        log_infof("Peer connection failed (err 0x%02x)\n", err);
    }
    else
    {
        log_info("Peer connected\n");
        if (terminal_conn == NULL)
        {
            terminal_conn = conn;
            uuid = SERVICE_UUID;
            discover_params.uuid = &uuid.uuid;
            discover_params.func = &_discover_;
            discover_params.start_handle = BT_ATT_FIRST_ATTTRIBUTE_HANDLE;
            discover_params.end_handle = BT_ATT_LAST_ATTTRIBUTE_HANDLE;
            discover_params.type = BT_GATT_DISCOVER_PRIMARY;

            err = bt_gatt_discover(terminal_conn, &discover_params);
            if (err)
            {
                log_errorf("Discover failed(err %d)\n", err);
                return;
            }
        }
    }
}

static void _peer_disconnected_(struct bt_conn *conn, uint8_t reason)
{
    log_infof("Peer disconnected (reason 0x%02x)\n", reason);
    terminal_conn = NULL;
    k_mutex_lock(&state_mu, K_FOREVER);
    dongle_state = DONGLE_UPLOAD_STATE_LOCKED;
    k_mutex_unlock(&state_mu);
}

static struct bt_conn_cb conn_callbacks = {
    .connected = _peer_connected_,
    .disconnected = _peer_disconnected_,
};

static void _peer_auth_cancel_(struct bt_conn *conn)
{
    char addr[BT_ADDR_LE_STR_LEN];

    bt_addr_le_to_str(bt_conn_get_dst(conn), addr, sizeof(addr));

    log_infof("Peer pairing cancelled: %s\n", addr);
}

static struct bt_conn_auth_cb auth_cb_display = {
    .cancel = _peer_auth_cancel_,
};

int access_advertise()
{

    dongle_state = DONGLE_UPLOAD_STATE_LOCKED;

    info_bytes(ad[0].data, ad[0].data_len, "ad data");
    int err = bt_le_adv_start(BT_LE_ADV_CONN_NAME, ad, ARRAY_SIZE(ad), NULL, 0);
    if (err)
    {
        log_infof("Advertising failed to start (err %d)\n", err);
        return err;
    }

    log_info("Advertising successfully started\n");

    bt_conn_cb_register(&conn_callbacks);
    bt_conn_auth_cb_register(&auth_cb_display);

    // obtain and report adverisement address
    char addr_s[BT_ADDR_LE_STR_LEN];
    bt_addr_le_t addr = {0};
    size_t count = 1;

    bt_id_get(&addr, &count);
    bt_addr_le_to_str(&addr, addr_s, sizeof(addr_s));

    log_infof("advertising started with address %s\n", addr_s);

    return 0;
}
```

## src/access.h
```c
#ifndef DONGLE_ACCESS__H
#define DONGLE_ACCESS__H

// TERMINAL INTERACTION
// This is a connection-oriented protocol for external upload
// through a user-interface device. Dongle acts as the peripheral
// and accepts connections while proceeding with normal operation.
// Only the 'delayed-release' mechanism is supported right now.
// Data is currently unencrypted when sent to the terminal.

#include <stdint.h>

#include "./dongle.h"
#include "./storage.h"

// SERVICE UUID: e7f72a03-803b-410a-98d4-4be5fad8e217
#define DONGLE_INTERACT_SERVICE_ID_0 0xe7f72a03
#define DONGLE_INTERACT_SERVICE_ID_1 0x803b
#define DONGLE_INTERACT_SERVICE_ID_2 0x410a
#define DONGLE_INTERACT_SERVICE_ID_3 0x98d4
#define DONGLE_INTERACT_SERVICE_ID_4 0x4be5fad8e217

// Macro for expressing indexed UUIDS for use in the access protocol
// These are based on the primary service ID (index 0) and support
// a large number of IDs - assuming that the 6-byte part of the base
// UUID is well below the max val.
#define DONGLE_INTERACT_UUID(i) BT_UUID_128_ENCODE( \
    DONGLE_INTERACT_SERVICE_ID_0,                   \
    DONGLE_INTERACT_SERVICE_ID_1,                   \
    DONGLE_INTERACT_SERVICE_ID_2,                   \
    DONGLE_INTERACT_SERVICE_ID_3,                   \
    DONGLE_INTERACT_SERVICE_ID_4 + i)

#define DONGLE_SERVICE_UUID DONGLE_INTERACT_UUID(0)

#define DONGLE_CHARACTERISTIC_UUID DONGLE_INTERACT_UUID(1)

// Data types
#define DONGLE_UPLOAD_DATA_TYPE_OTP 0x01
#define DONGLE_UPLOAD_DATA_TYPE_NUM_RECS 0x02
#define DONGLE_UPLOAD_DATA_TYPE_ACK_NUM_RECS 0x03
#define DONGLE_UPLOAD_DATA_TYPE_DATA_0 0x04
#define DONGLE_UPLOAD_DATA_TYPE_ACK_DATA_0 0x05
#define DONGLE_UPLOAD_DATA_TYPE_DATA_1 0x06
#define DONGLE_UPLOAD_DATA_TYPE_ACK_DATA_1 0x07
#define DONGLE_UPLOAD_DATA_TYPE_DATA_2 0x08
#define DONGLE_UPLOAD_DATA_TYPE_ACK_DATA_2 0x09
#define DONGLE_UPLOAD_DATA_TYPE_DATA_3 0x0a
#define DONGLE_UPLOAD_DATA_TYPE_ACK_DATA_3 0x0b
#define DONGLE_UPLOAD_DATA_TYPE_DATA_4 0x0c
#define DONGLE_UPLOAD_DATA_TYPE_ACK_DATA_4 0x0d

typedef union
{
    uint8_t flags;
    struct
    {
        uint8_t _;
        uint8_t val[sizeof(dongle_otp_val)];
    } otp;
    struct
    {
        uint8_t _;
        uint8_t val[sizeof(enctr_entry_counter_t)];
    } num_recs;
    struct
    {
        uint8_t _;
        uint8_t bytes[19];
    } data;
} interact_state;

int access_advertise();
void peer_update();
void interact_update();
dongle_storage *get_dongle_storage();

#endif
```

## src/dongle.c
```c
//
// Dongle Application for PanCast Beacon logging
// Early version based on the bluetooth-central example from Zephyr
// This acts as a passive scanner that makes no connections and
// instead interprets and logs payload data from PanCast beacons.
//

#include "./dongle.h"

#define LOG_LEVEL__INFO
#define MODE__TEST

#include <sys/printk.h>
#include <sys/util.h>
#include <zephyr.h>
#include <stdio.h>

#include <bluetooth/bluetooth.h>
#include <bluetooth/hci.h>
#include <bluetooth/uuid.h>
#include <bluetooth/conn.h>
#include <drivers/flash.h>

#include "./storage.h"
#include "./test.h"
#include "./access.h"
#include "./encounter.h"

#include "../../common/src/log.h"
#include "../../common/src/pancast.h"
#include "../../common/src/test.h"
#include "../../common/src/util.h"

// STATIC PARAMETERS
// (Approx) number of time units between each report written to output
#define DONGLE_REPORT_INTERVAL 30

// number of distinct broadcast ids to keep track of at one time
#define DONGLE_MAX_BC_TRACKED 16

//
// GLOBAL MEMORY
// All of the variables used throughout the main program are allocated here

// 1. Mutual exclusion
// Access for both central updates and scan interupts
// is given on a FIFO basis
struct k_mutex dongle_mu;
#define LOCK k_mutex_lock(&dongle_mu, K_FOREVER);
#define UNLOCK k_mutex_unlock(&dongle_mu);

void dongle_lock()
{
    LOCK
}

void dongle_unlock(){
    UNLOCK}

// 2. Config
dongle_config_t config;

// 3. Operation
dongle_storage storage;
dongle_storage *get_dongle_storage()
{
    return &storage;
}
dongle_epoch_counter_t epoch;
struct k_timer kernel_time;
dongle_timer_t dongle_time; // main dongle timer
dongle_timer_t report_time;
beacon_eph_id_t
    cur_id[DONGLE_MAX_BC_TRACKED]; // currently observed ephemeral id
dongle_timer_t
    obs_time[DONGLE_MAX_BC_TRACKED]; // time of last new id observation
size_t cur_id_idx;

// 3. Reporting
enctr_entry_counter_t enctr_entries_offset;

// 4. Testing
// Allocation is conditioned on the compile setting
#ifdef MODE__TEST
int test_errors = 0;
#define TEST_MAX_ENCOUNTERS 64
int test_encounters = 0;
int total_test_encounters = 0;
dongle_encounter_entry test_encounter_list[TEST_MAX_ENCOUNTERS];
#endif

//
// ROUTINES
//

// MAIN
// Entrypoint of the application
// Initialize bluetooth, then call advertising and scan routines
void main(void)
{
    log_infof("Starting %s on %s\n", CONFIG_BT_DEVICE_NAME, CONFIG_BOARD);

#ifdef MODE__TEST
    log_info("RUNNING IN TEST MODE\n");
#endif

    int err;

    err = bt_enable(NULL);
    if (err)
    {
        log_errorf("Bluetooth init failed (err %d)\n", err);
        return;
    }

    log_info("Bluetooth initialized\n");

    if (access_advertise())
    {
        return;
    }

    dongle_scan();
}

// SCAN
// Call init routine, begin advertising with fixed parameters,
// and enter the main loop.
void dongle_scan(void)
{

    dongle_init();

    // Scan Start
    int err = err = bt_le_scan_start(
        BT_LE_SCAN_PARAM(
            BT_LE_SCAN_TYPE_PASSIVE,   // passive scan
            BT_LE_SCAN_OPT_NONE,       // no options; in particular, allow duplicates
            BT_GAP_SCAN_FAST_INTERVAL, // interval
            BT_GAP_SCAN_FAST_WINDOW    // window
            ),
        dongle_log);
    if (err)
    {
        log_errorf("Scanning failed to start (err %d)\n", err);
        return;
    }
    else
    {
        log_debug("Scanning successfully started\n");
        dongle_loop();
    }
}

// INIT
// Call load routine, and set variables to their
// initial value. Also initialize timing structs
void dongle_init()
{
    k_mutex_init(&dongle_mu);

    dongle_load();

    dongle_time = config.t_init;
    report_time = dongle_time;
    cur_id_idx = 0;
    epoch = 0;
    enctr_entries_offset = 0;

    k_timer_init(&kernel_time, NULL, NULL);

// Timer zero point
#define DUR K_MSEC(DONGLE_TIMER_RESOLUTION)
    k_timer_start(&kernel_time, DUR, DUR);
#undef DUR // Initial time
}

// LOAD
// Load state and configuration into memory
void dongle_load()
{
    dongle_storage_init(&storage);
    dongle_storage_load_config(&storage, &config);
#ifdef MODE__TEST
    config.id = TEST_DONGLE_ID;
    config.t_init = TEST_DONGLE_INIT_TIME;
    config.backend_pk_size = TEST_BACKEND_KEY_SIZE;
    config.backend_pk = TEST_BACKEND_PK;
    config.dongle_sk_size = TEST_DONGLE_SK_SIZE;
    config.dongle_sk = TEST_DONGLE_SK;
    dongle_storage_save_config(&storage, &config);
    dongle_storage_save_otp(&storage, TEST_OTPS);
#endif
}

// MAIN LOOP
// timing and control logic is largely the same as the beacon
// application. The main difference is that scanning does not
// require restart for a new epoch.
void dongle_loop()
{
    uint32_t timer_status = 0;

    int err = 0;
    while (!err)
    {
        // get most updated time
        timer_status = k_timer_status_sync(&kernel_time);
        timer_status += k_timer_status_get(&kernel_time);
        LOCK dongle_time += timer_status;

        // update epoch
        static dongle_epoch_counter_t old_epoch;
        old_epoch = epoch;
#define t_init config.t_init
        epoch = epoch_i(dongle_time, t_init);
#undef t_init
        if (epoch != old_epoch)
        {
            log_debugf("EPOCH STARTED: %u\n", epoch);
            // TODO: log time to flash
        }
        dongle_report();
        UNLOCK
    }
}

static int
decode_payload(uint8_t *data)
{
    data[0] = data[1];
    data[1] = data[MAX_BROADCAST_SIZE - 1];
    return 0;
}

// matches the schema defined by encode
static int decode_encounter(encounter_broadcast_t *dat,
                            encounter_broadcast_raw_t *raw)
{
    uint8_t *src = (uint8_t *)raw;
    size_t pos = 0;
#define link(dst, type)          \
    (dst = (type *)(src + pos)); \
    pos += sizeof(type)
    link(dat->t, beacon_timer_t);
    link(dat->b, beacon_id_t);
    link(dat->loc, beacon_location_id_t);
    link(dat->eph, beacon_eph_id_t);
#undef link
    return 0;
}

// compares two ephemeral ids
int compare_eph_id(beacon_eph_id_t *a, beacon_eph_id_t *b)
{
#define A (a->bytes)
#define B (b->bytes)
    for (int i = 0; i < BEACON_EPH_ID_HASH_LEN; i++)
    {
        if (A[i] != B[i])
            return 1;
    }
#undef B
#undef A
    return 0;
}

static void _dongle_encounter_(encounter_broadcast_t *enc, size_t i)
{
#define en (*enc)
    // when a valid encounter is detected
    // log the encounter
    log_debugf("Beacon Encounter (id=%u, t_b=%u, t_d=%u)\n", *en.b, *en.t,
               dongle_time);
    // Write to storage
    dongle_storage_print(&storage, 0x22000, 32);
    dongle_storage_log_encounter(&storage, enc->loc, enc->b, enc->t, &dongle_time,
                                 enc->eph);
    dongle_storage_print(&storage, 0x22000, 32);
#ifdef MODE__TEST
    if (*en.b == TEST_BEACON_ID)
    {
        test_encounters++;
    }
#define test_en (test_encounter_list[total_test_encounters])
    test_en.location_id = *enc->loc;
    test_en.beacon_id = *enc->b;
    test_en.beacon_time = *enc->t;
    test_en.dongle_time = dongle_time;
    test_en.eph_id = *enc->eph;
#undef test_en
    total_test_encounters++;
#endif
    // reset the observation time
    obs_time[i] = dongle_time;
#undef en
}

static void _dongle_track_(encounter_broadcast_t *enc)
{
#define en (*enc)

    // Check the broadcast UUID
    beacon_id_t service_id = (*en.b & BEACON_SERVICE_ID_MASK) >> 16;
    if (service_id != BROADCAST_SERVICE_ID)
    {
        log_debugf("Broadcast skipped; service id 0x%x does not match\n", service_id);
        return;
    }

    // determine which tracked id, if any, is a match
    size_t i = DONGLE_MAX_BC_TRACKED;
    for (size_t j = 0; j < DONGLE_MAX_BC_TRACKED; j++)
    {
        if (!compare_eph_id(en.eph, &cur_id[j]))
        {
            i = j;
        }
    }
    if (i == DONGLE_MAX_BC_TRACKED)
    {
        // if no match was found, start tracking the new id, replacing the oldest
        // one currently tracked
        i = cur_id_idx;
        log_debugf("new ephemeral id observed (beacon=%u), tracking at index %d\n",
                   *en.b, i);
        print_bytes(en.eph->bytes, BEACON_EPH_ID_HASH_LEN, "eph_id");
        cur_id_idx = (cur_id_idx + 1) % DONGLE_MAX_BC_TRACKED;
        memcpy(&cur_id[i], en.eph->bytes, BEACON_EPH_ID_HASH_LEN);
        obs_time[i] = dongle_time;
    }
    else
    {
        // when a matching ephemeral id is observed
        // check conditions for a valid encounter
        dongle_timer_t dur = dongle_time - obs_time[i];
        if (dur >= DONGLE_ENCOUNTER_MIN_TIME)
        {
            _dongle_encounter_(&en, i);
        }
    }
#undef en
}

void dongle_log(const bt_addr_le_t *addr, int8_t rssi, uint8_t type,
                struct net_buf_simple *ad)
{
    char addr_str[BT_ADDR_LE_STR_LEN];
    bt_addr_le_to_str(addr, addr_str, sizeof(addr_str));
    // Filter mis-sized packets
    if (ad->len != ENCOUNTER_BROADCAST_SIZE + 1)
    {
        return;
    }
    decode_payload(ad->data);
    LOCK encounter_broadcast_t en;
    decode_encounter(&en, (encounter_broadcast_raw_t *)ad->data);
    _dongle_track_(&en);
    UNLOCK
}

uint8_t compare_encounter_entry(dongle_encounter_entry a, dongle_encounter_entry b)
{
    uint8_t res = 0;
    log_debug("comparing ids\n");
#define check(val, idx) res |= (val << idx)
    check(!(a.beacon_id == b.beacon_id), 0);
    log_debug("comparing beacon time\n");
    check(!(a.beacon_time == b.beacon_time), 1);
    log_debug("comparing dongle time\n");
    check(!(a.dongle_time == b.dongle_time), 2);
    log_debug("comparing location ids\n");
    check(!(a.location_id == b.location_id), 3);
    log_debug("comparing eph. ids\n");
    check(compare_eph_id(&a.eph_id, &b.eph_id), 4);
#undef check
    return res;
}

int _report_encounter_(enctr_entry_counter_t i, dongle_encounter_entry *entry)
{
    //log_infof("%.4llu.", i);
    //_display_encounter_(entry);
#ifdef MODE__TEST
    log_debug("comparing logged encounter against test record\n");
    dongle_encounter_entry test_en = test_encounter_list[i - enctr_entries_offset];
    uint8_t comp = compare_encounter_entry(*entry, test_en);
    if (comp)
    {
        log_info("FAILED: entry mismatch\n");
        log_infof("Comp=%u\n", comp);
        test_errors++;
        log_info("Entry from log:\n");
        _display_encounter_(entry);
        log_info("Test:\n");
        _display_encounter_(&test_en);
    }
    else
    {
        log_debug("Entries MATCH\n");
    }
#endif
    return 1;
}

void dongle_report()
{
    // do report
    if (dongle_time - report_time >= DONGLE_REPORT_INTERVAL)
    {
        report_time = dongle_time;
        log_infof("\n*** Begin Report for %s ***\n\n", CONFIG_BT_DEVICE_NAME);
        log_infof("ID: %u\n", config.id);
        log_infof("Initial clock: %u\n", config.t_init);
        log_infof("Backend public key (%u bytes)\n", config.backend_pk_size);
        log_infof("Secret key (%u bytes)\n", config.dongle_sk_size);
        log_infof("dongle timer: %u\n", dongle_time);

        // Run Tests
#ifdef MODE__TEST
        log_info("\nTests:\n");
        test_errors = 0;
#define FAIL(msg) (log_infof("FAILURE: %s\n", msg), test_errors++)

        log_info("? Testing that OTPs are loaded\n");
        int otp_idx = dongle_storage_match_otp(&storage, TEST_OTPS[7].val);
        if (otp_idx != 7)
        {
            FAIL("Index 7 Not loaded correctly");
        }
        otp_idx = dongle_storage_match_otp(&storage, TEST_OTPS[0].val);
        if (otp_idx != 0)
        {
            FAIL("Index 0 Not loaded correctly");
        }
        log_info("? Testing that OTP cannot be re-used\n");
        otp_idx = dongle_storage_match_otp(&storage, TEST_OTPS[7].val);
        if (otp_idx >= 0)
        {
            FAIL("Index 7 was found again");
        }
        // Restore OTP data
        // Need to re-save config as the shared page must be erased
        dongle_storage_save_config(&storage, &config);
        dongle_storage_save_otp(&storage, TEST_OTPS);

        log_info("? Testing that logged encounters are correct\n");
        dongle_storage_load_encounter(&storage, enctr_entries_offset,
                                      _report_encounter_);
        log_info("? Testing that beacon broadcast was received\n");
        if (test_encounters < 1)
        {
            FAIL("Not enough encounters.");
            log_infof("Encounters logged in window: %d\n",
                      test_encounters);
        }
        if (test_errors)
        {
            log_infof("\n   x Tests Failed: status = %d\n\n", test_errors);
        }
        else
        {

            log_info("\n    ✔ Tests Passed\n\n");
        }
#undef FAIL
        test_encounters = 0;
        total_test_encounters = 0;
#endif
        enctr_entry_counter_t num = dongle_storage_num_encounters(&storage);
        log_infof("Encounters logged since last report: %llu\n", num - enctr_entries_offset);
        log_infof("Total Encounters logged: %llu\n", num);
        enctr_entries_offset = num;
        log_info("\n*** End Report ***\n\n");
    }
}
```

## src/dongle.h
```c
#ifndef DONGLE__H
#define DONGLE__H

#include <bluetooth/bluetooth.h>
#include <bluetooth/hci.h>
#include <bluetooth/uuid.h>
#include <bluetooth/conn.h>

#include "../../common/src/pancast.h"

typedef struct
{
    beacon_eph_id_t *eph;
    beacon_location_id_t *loc;
    beacon_id_t *b;
    beacon_timer_t *t;
} encounter_broadcast_t;

typedef uint64_t enctr_entry_counter_t;

typedef uint64_t dongle_otp_flags;
typedef uint64_t dongle_otp_val;

typedef struct
{
    dongle_otp_flags flags;
    dongle_otp_val val;
} dongle_otp_t;

typedef dongle_otp_t otp_set[NUM_OTP];

typedef struct
{
    dongle_id_t id;
    dongle_timer_t t_init;
    key_size_t backend_pk_size; // size of backend public key
    pubkey_t backend_pk;        // Backend public key
    key_size_t dongle_sk_size;  // size of secret key
    seckey_t dongle_sk;         // Secret Key
} dongle_config_t;

typedef struct
{
    beacon_location_id_t location_id;
    beacon_id_t beacon_id;
    beacon_timer_t beacon_time;
    dongle_timer_t dongle_time;
    beacon_eph_id_t eph_id;
} dongle_encounter_entry;

void dongle_scan(void);
void dongle_init();
void dongle_load();
void dongle_loop();
void dongle_report();
void dongle_log(const bt_addr_le_t *addr, int8_t rssi, uint8_t type,
                struct net_buf_simple *ad);

void dongle_lock();
void dongle_unlock();

#endif
```

## src/encounter.h
```c
#ifndef DONGLE_ENCOUNTER__H
#define DONGLE_ENCOUNTER__H

#include "./dongle.h"

void _display_encounter_(dongle_encounter_entry *entry);
void display_eph_id_of(dongle_encounter_entry *entry);

#endif
```

## src/storage.c
```c
#define LOG_LEVEL__INFO

#include "./storage.h"

#include <drivers/flash.h>

#include "../../common/src/log.h"
#include "../../common/src/util.h"

#define prev_multiple(k, n) ((n) - ((n) % (k)))
#define next_multiple(k, n) ((n) + ((k) - ((n) % (k)))) // buggy

off_t off; // flash offset

static bool _flash_page_info_(const struct flash_pages_info *info, void *data)
{
#define sto ((dongle_storage *)data)
    if (!sto->num_pages)
    {
        sto->page_size = info->size;
    }
    else if (info->size != sto->page_size)
    {
        log_errorf("differing page sizes! (%u and %u)\n", info->size,
                   sto->page_size);
    }
    sto->num_pages++;
    return true;
#undef sto
}

#define st (*sto)

void dongle_storage_erase(dongle_storage *sto, storage_addr_t offset)
{
    log_debugf("erasing page at 0x%x\n", (offset));
    flash_erase(st.dev, (offset), st.page_size);
}

#define erase(addr) dongle_storage_erase(sto, addr)

void pre_erase(dongle_storage *sto, size_t write_size)
{
// Erase before write
#define page_num(o) ((o) / st.page_size)
    if ((off % st.page_size) == 0)
    {
        erase(off);
    }
    else if (page_num(off + write_size) > page_num(off))
    {
#undef page_num
        erase(next_multiple(st.page_size, off));
    }
}

int _flash_read_(dongle_storage *sto, void *data, size_t size)
{
    log_debugf("reading %d bytes from flash at address 0x%x\n", size, off);
    return flash_read(st.dev, off, data, size);
}

int _flash_write_(dongle_storage *sto, void *data, size_t size)
{
    log_debugf("writing %d bytes to flash at address 0x%x\n", size, off);
    return flash_write(st.dev, off, data, size)
           ? log_error("Error writing flash\n"),
           1 : 0;
}

void dongle_storage_init(dongle_storage *sto)
{
    log_info("Initializing storage\n");
    off = 0;
    st.map.enctr_entries = 0;
    st.dev = device_get_binding(DT_CHOSEN_ZEPHYR_FLASH_CONTROLLER_LABEL);
    log_info("Getting flash information.\n");
    st.min_block_size = flash_get_write_block_size(st.dev);
    st.num_pages = 0;
    flash_page_foreach(st.dev, _flash_page_info_, sto);
    log_infof("Pages: %d, Page Size: %u\n", st.num_pages, st.page_size);
    st.map.config = FLASH_OFFSET;
}

#define cf (*cfg)

void dongle_storage_load_config(dongle_storage *sto, dongle_config_t *cfg)
{
    log_info("Loading config\n");
    off = st.map.config;
#define read(size, dst) (_flash_read_(sto, dst, size), off += size)
    read(sizeof(dongle_id_t), &cf.id);
    read(sizeof(dongle_timer_t), &cf.t_init);
    read(sizeof(key_size_t), &cf.backend_pk_size);
    read(PK_MAX_SIZE, &cf.backend_pk);
    read(sizeof(key_size_t), &cf.dongle_sk_size);
    read(SK_MAX_SIZE, &cf.dongle_sk);
    st.map.otp = off;
    // log start is pushed onto the next blank page
    st.map.log = next_multiple(st.page_size,
                               st.map.otp + (NUM_OTP * sizeof(dongle_otp_t)));
#undef read
}

void dongle_storage_save_config(dongle_storage *sto, dongle_config_t *cfg)
{
    log_debug("Saving config\n");
    off = st.map.config;
#define write(data, size) (pre_erase(sto, size), _flash_write_(sto, data, size), off += size)
    write(&cf.id, sizeof(dongle_id_t));
    write(&cf.t_init, sizeof(dongle_timer_t));
    write(&cf.backend_pk_size, sizeof(key_size_t));
    write(&cf.backend_pk, PK_MAX_SIZE);
    write(&cf.dongle_sk_size, sizeof(key_size_t));
    write(&cf.dongle_sk, SK_MAX_SIZE);
#undef write
}

#undef cf

#define OTP(i) (st.map.otp + (i * sizeof(dongle_otp_t)))

void dongle_storage_load_otp(dongle_storage *sto, int i, dongle_otp_t *otp)
{
    off = OTP(i), _flash_read_(sto, otp, sizeof(dongle_otp_t));
}

void dongle_storage_save_otp(dongle_storage *sto, otp_set otps)
{
    log_debug("Saving OTPs\n");
    for (int i = 0; i < NUM_OTP; i++)
    {
        off = OTP(i);
        pre_erase(sto, sizeof(dongle_otp_t));
        _flash_write_(sto, &otps[i], sizeof(dongle_otp_t));
    }
}

int otp_is_used(dongle_otp_t *otp)
{
    return !((otp->flags & 0x0000000000000001) >> 0);
}

int dongle_storage_match_otp(dongle_storage *sto, uint64_t val)
{
    dongle_otp_t otp;
    for (int i = 0; i < NUM_OTP; i++)
    {
        dongle_storage_load_otp(sto, i, &otp);
        if (otp.val == val && !otp_is_used(&otp))
        {
            otp.flags &= 0xfffffffffffffffe;
            off = OTP(i),
            _flash_write_(sto, &otp, sizeof(dongle_otp_t));
            return i;
        }
    }
    return -1;
}

enctr_entry_counter_t dongle_storage_num_encounters(dongle_storage *sto)
{
    return st.map.enctr_entries;
}

// Reflects the total size of the entry in storage while taking
// minimum alignment into account.
#define ENCOUNTER_ENTRY_SIZE (sizeof(beacon_location_id_t) + sizeof(beacon_id_t) + \
                              sizeof(beacon_timer_t) + sizeof(dongle_timer_t) +    \
                              BEACON_EPH_ID_SIZE)

//#define ENCOUNTER_LOG_BASE (ENCOUNTER_BASE + sizeof(flash_check_t))
#define ENCOUNTER_LOG_OFFSET(j) (st.map.log + (j * ENCOUNTER_ENTRY_SIZE))

void dongle_storage_load_encounter(dongle_storage *sto,
                                   enctr_entry_counter_t i, dongle_encounter_cb cb)
{
    dongle_encounter_entry en;
    if (i >= st.map.enctr_entries)
    {
        log_errorf("Starting index for encounter log (%llu) is too large\n", i);
    }
    log_debugf("loading log entries starting at index %llu\n", i);
    do
    {
        if (i < st.map.enctr_entries)
        {
            dongle_storage_load_single_encounter(sto, i, &en);
        }
        else
        {
            break;
        }
        i++;
    } while (cb(i - 1, &en));
}

void dongle_storage_load_single_encounter(dongle_storage *sto,
                                          enctr_entry_counter_t i, dongle_encounter_entry *en)
{
    off = ENCOUNTER_LOG_OFFSET(i);
#define read(size, dst) _flash_read_(sto, dst, size), off += size
    read(sizeof(beacon_id_t), &en->beacon_id);
    read(sizeof(beacon_location_id_t), &en->location_id);
    read(sizeof(beacon_timer_t), &en->beacon_time);
    read(sizeof(dongle_timer_t), &en->dongle_time);
    read(BEACON_EPH_ID_SIZE, &en->eph_id);
#undef read
}

void dongle_storage_log_encounter(dongle_storage *sto,
                                  beacon_location_id_t *location_id,
                                  beacon_id_t *beacon_id,
                                  beacon_timer_t *beacon_time,
                                  dongle_timer_t *dongle_time,
                                  beacon_eph_id_t *eph_id)
{
    storage_addr_t start = ENCOUNTER_LOG_OFFSET(st.map.enctr_entries);
    off = start;
    log_debugf("write log; existing entries: %llu, offset: 0x%x\n", st.map.enctr_entries, off);
    pre_erase(sto, ENCOUNTER_ENTRY_SIZE);
#define write(data, size) \
    _flash_write_(sto, data, size), off += size
    write(beacon_id, sizeof(beacon_id_t));
    write(location_id, sizeof(beacon_location_id_t));
    write(beacon_time, sizeof(beacon_timer_t));
    write(dongle_time, sizeof(dongle_timer_t));
    write(eph_id, BEACON_EPH_ID_SIZE);
    log_debugf("total size: %u (entry size=%d)\n", off - start, ENCOUNTER_ENTRY_SIZE);
#undef write
    st.map.enctr_entries++;
    log_debugf("log now contains %llu entries\n", st.map.enctr_entries);
}

int dongle_storage_print(dongle_storage *sto, storage_addr_t addr, size_t len)
{
    if (len > DONGLE_STORAGE_MAX_PRINT_LEN)
    {
        log_error("Cannot print that many bytes of flash");
        return 1;
    }
    uint8_t data[DONGLE_STORAGE_MAX_PRINT_LEN];
    off = addr;
    _flash_read_(sto, data, len);
    print_bytes(data, len, "Flash data");
    return 0;
}

#undef block_align
#undef st
#undef align
#undef next_multiple
#undef prev_multiple
```

## src/storage.h
```c
#ifndef STORAGE__H
#define STORAGE__H

// Non-Volatile storage
// Defines a simple API to read and write specific data structures
// with minimal coupling the underlying drivers.

#include "./dongle.h"

#include <drivers/flash.h>

#define FLASH_OFFSET 0x2D000

typedef off_t storage_addr_t;

typedef struct
{
    storage_addr_t config;
    storage_addr_t otp;
    storage_addr_t log;
    enctr_entry_counter_t enctr_entries; // number of entries
} _dongle_storage_map_;

typedef struct
{
    const struct device *dev;
    size_t min_block_size;
    int num_pages;
    size_t page_size;
    _dongle_storage_map_ map;
} dongle_storage;

// STORAGE INIT
// Should initialize the internal storage representation,
// including system-level information. Application configs like
// the storage map are left partially uninitialized.
// This allows *load_config* to be used.
void dongle_storage_init(dongle_storage *sto);

// LOAD CONFIG
// Should load application configuration data into the provided
// container, and set the map to allow load_otp to be used.
void dongle_storage_load_config(dongle_storage *sto, dongle_config_t *cfg);

// Write an existing config to storage
void dongle_storage_save_config(dongle_storage *sto, dongle_config_t *cfg);

// LOAD OTP
// Should read the data associated with the ith OTP code into
// the container.
void dongle_storage_load_otp(dongle_storage *sto, int i, dongle_otp_t *otp);

// Container for OTPs loaded during testing
typedef dongle_otp_t otp_set[NUM_OTP];

// Save a pre-determined list of OTPs
void dongle_storage_save_otp(dongle_storage *sto, otp_set otps);

// Determine if a given otp is used
int otp_is_used(dongle_otp_t *otp);

// If an unused OTP exists with the given value, returns its index
// and marks the code as used. Otherwise returns a negative value
int dongle_storage_match_otp(dongle_storage *sto, uint64_t val);

// Determine the number of encounters currently logged
enctr_entry_counter_t dongle_storage_num_encounters(dongle_storage *sto);

// LOAD ENCOUNTER
// API is defined using a callback structure
typedef int (*dongle_encounter_cb)(enctr_entry_counter_t i, dongle_encounter_entry *entry);

// load function iterates through the records, and calls cb for each
// variable i is provided as the index into the log
void dongle_storage_load_encounter(dongle_storage *sto,
                                   enctr_entry_counter_t i, dongle_encounter_cb cb);

void dongle_storage_load_single_encounter(dongle_storage *sto,
                                          enctr_entry_counter_t i, dongle_encounter_entry *);

// WRITE ENCOUNTER
void dongle_storage_log_encounter(dongle_storage *sto,
                                  beacon_location_id_t *loc,
                                  beacon_id_t *beacon_id,
                                  beacon_timer_t *beacon_time,
                                  dongle_timer_t *dongle_time,
                                  beacon_eph_id_t *eph_id);

#define DONGLE_STORAGE_MAX_PRINT_LEN 64

int dongle_storage_print(dongle_storage *, storage_addr_t, size_t);

#endif
```

## src/test.h
```c
#ifndef DONGLE_TEST__H
#define DONGLE_TEST__H

#include "../../common/src/pancast.h"
#include "./dongle.h"
#include "./storage.h"

static otp_set TEST_OTPS = {
    {0xffffffffffffffff,
     11111111},
    {0xffffffffffffffff,
     11112222},
    {0xffffffffffffffff,
     12121212},
    {0xffffffffffffffff,
     11010101},
    {0xffffffffffffffff,
     11144111},
    {0xffffffffffffffff,
     11111111},
    {0xffffffffffffffff,
     11115611},
    {0xffffffffffffffff,
     11111118},
    {0xffffffffffffffff,
     11111117},
    {0xffffffffffffffff,
     11111116},
    {0xffffffffffffffff,
     11118911},
    {0xffffffffffffffff,
     11111122},
    {0xffffffffffffffff,
     11334111},
    {0xffffffffffffffff,
     11111111},
    {0xffffffffffffffff,
     11111111},
    {0xffffffffffffffff,
     12345678}};

#endif
```

## src/upload.h
```c
#ifndef DONGLE_UPLOAD__H
#define DONGLE_UPLOAD__H

#define DONGLE_UPLOAD_DATA_TYPE_OTP 0x01
#define DONGLE_UPLOAD_DATA_TYPE_NUM_RECS 0x02
#define DONGLE_UPLOAD_DATA_TYPE_ACK_NUM_RECS 0x03
#define DONGLE_UPLOAD_DATA_TYPE_DATA_0 0x04
#define DONGLE_UPLOAD_DATA_TYPE_ACK_DATA_0 0x05
#define DONGLE_UPLOAD_DATA_TYPE_DATA_1 0x06
#define DONGLE_UPLOAD_DATA_TYPE_ACK_DATA_1 0x07
#define DONGLE_UPLOAD_DATA_TYPE_DATA_2 0x08
#define DONGLE_UPLOAD_DATA_TYPE_ACK_DATA_2 0x09
#define DONGLE_UPLOAD_DATA_TYPE_DATA_3 0x0a
#define DONGLE_UPLOAD_DATA_TYPE_ACK_DATA_3 0x0b
#define DONGLE_UPLOAD_DATA_TYPE_DATA_4 0x0c
#define DONGLE_UPLOAD_DATA_TYPE_ACK_DATA_4 0x0d

#endif
```
