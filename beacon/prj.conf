## CMakeLists.txt
```
# Find Zephyr. This also loads Zephyr's build system.
cmake_minimum_required(VERSION 3.13.1)
find_package(Zephyr)
project(pancast_beacon)


# Add your source file to the "app" target. This must come after
# find_package(Zephyr) which defines the target.
target_sources(app PRIVATE src/beacon.h)
target_sources(app PRIVATE src/beacon.c)
target_sources(app PRIVATE src/storage.c)
```

## prj.conf
```kconfig
CONFIG_BT=y
#CONFIG_BT_DEBUG_LOG=y
CONFIG_BT_DEVICE_NAME="PanCast Test Beacon"
CONFIG_TINYCRYPT=y
CONFIG_TINYCRYPT_SHA256=y
CONFIG_FLASH=y
CONFIG_BT_CTLR_ADVANCED_FEATURES=y
CONFIG_BT_CTLR_TX_PWR_DYNAMIC_CONTROL=y
```

## src/beacon.c
```c
//
// Beacon Application for PanCast Encounter logging
// Early version based on the bluetooth-beacon example from Zephyr
// Acts as a bluetooth beacon, using a full legacy-advertising
// payload to broadcast relevant information. See white-paper for
// details.
//

#include "beacon.h"
#include "app.h"
#include "nvm3_lib.h"
#include "common/src/util/stats.h"

#define APPL_VERSION "0.1.1"

#define MODE__STAT

#define LOG_LEVEL__DEBUG

#include <string.h>

#include "sl_bluetooth.h"
#include "app_log.h"
#include "led.h"
#include "storage.h"

#include "common/src/constants.h"
#include "common/src/settings.h"
#include "common/src/util/util.h"
#include "common/src/util/log.h"
#include "common/src/test.h"

//
// GLOBAL MEMORY
//
extern float adv_start;

// The advertising set handle allocated from Bluetooth stack.
static uint8_t advertising_set_handle = PER_ADV_HANDLE;

// Config
beacon_config_t config;

// Default Operation
beacon_storage storage;
sl_sleeptimer_timer_handle_t led_timer;

static beacon_timer_t beacon_time;    // Beacon Clock
static beacon_eph_id_t beacon_eph_id; // Ephemeral ID
static beacon_epoch_counter_t epoch;  // track the current time epoch
static beacon_timer_t cycles;         // total number of updates.
//
// Bluetooth
// Advertising handle
static uint8_t legacy_set_handle = 0xf1;
static bt_wrapper_t payload; // container for actual blutooth payload

#if MODE__SL_BEACON_TEST_CONFIG
static pubkey_t TEST_BACKEND_PK = {
  {0xad, 0xf4, 0xca, 0x6c, 0xa6, 0xd9, 0x11, 0x22}
};

static beacon_sk_t TEST_BEACON_SK = {
  {0xcb, 0x43, 0xf7, 0x56, 0x16, 0x25, 0xb3, 0xd0,
   0xd0, 0xbe, 0xad, 0xf4, 0x55, 0x66, 0x77, 0x99}
};
#endif

//
// ROUTINES
//

static void beacon_config_init(beacon_config_t *cfg)
{
  if (!cfg)
    return;

  cfg->backend_pk = malloc(PK_MAX_SIZE);
  memset(cfg->backend_pk, 0, PK_MAX_SIZE);

  cfg->beacon_sk = malloc(SK_MAX_SIZE);
  memset(cfg->beacon_sk, 0, SK_MAX_SIZE);
}

static void beacon_load()
{
  beacon_config_init(&config);
  beacon_storage_init(&storage);

  // load data
  beacon_storage_load_config(&storage, &config);
  beacon_timer_t sto_t_cur = config.t_cur;
  nvm3_load_config(&storage, &config);

#if MODE__SL_BEACON_TEST_CONFIG
  config.beacon_id = TEST_BEACON_ID;
  config.beacon_location_id = TEST_BEACON_LOC_ID;
  config.t_init = TEST_BEACON_INIT_TIME;
  config.t_cur = 0;
  config.backend_pk_size = TEST_BACKEND_KEY_SIZE;
  memcpy(config.backend_pk, &TEST_BACKEND_PK, config.backend_pk_size);
  config.beacon_sk_size = TEST_BEACON_SK_SIZE;
  memcpy(config.beacon_sk, &TEST_BEACON_SK, config.beacon_sk_size);
  storage.test_filter_size = TEST_FILTER_LEN;
  beacon_storage_save_config(&storage, &config);
  nvm3_save_config(&storage, &config);
#endif

  log_expf("=== INIT sto.t_cur: %u nvm.t_cur: %u ===\r\n", sto_t_cur, config.t_cur);
  // if device re-flashed, t_cur would be zero, reset it in the NVM too
  if (sto_t_cur == 0) {
    config.t_cur = 0;
    nvm3_save_clock_cursor(&storage, &config);
  }
}

void beacon_info()
{
  bd_addr address;
  uint8_t address_type;

  sl_bt_system_get_identity_address(&address, &address_type);

  log_expf("%s", "=== Beacon Info: ===\r\n");
  log_expf("    Platform:                 %s\r\n", "Zephyr OS");
#define UK "Unknown"
#define CONFIG_BOARD UK
#define CONFIG_BT_DEVICE_NAME UK
  log_expf("    Board:                    %s\r\n", CONFIG_BOARD);
  log_expf("    Bluetooth device name:    %s\r\n", CONFIG_BT_DEVICE_NAME);
  log_expf("    Application version:      %s\r\n", APPL_VERSION);
  log_expf("    Beacon ID:                0x%x\r\n", config.beacon_id);
  log_expf("    Location ID:              0x%lx\r\n", config.beacon_location_id);
  log_expf("    MAC addr:                 %02X:%02X:%02X:%02X:%02X:%02X (%s)\r\n",
      address.addr[5], address.addr[4], address.addr[3], address.addr[2],
      address.addr[1], address.addr[0],
      (address_type == 1 ? "random" : "public"));
  log_expf("    Initial clock:            %u\r\n", config.t_init);
  log_expf("    Current clock:            %u\r\n", config.t_cur);
  log_expf("    Timer frequency:          %u Hz\r\n",
      sl_sleeptimer_get_timer_frequency());
  log_expf("    Backend public key size:  %u bytes\r\n", config.backend_pk_size);
  log_expf("    Secret key size:          %u bytes\r\n", config.beacon_sk_size);
  log_expf("    Timer resolution:         %u ms\r\n", BEACON_TIMER_RESOLUTION);
  log_expf("    Epoch length:             %u ms\r\n",
      BEACON_EPOCH_LENGTH * BEACON_TIMER_RESOLUTION);
  log_expf("    Report interval:          %u ms\r\n",
      BEACON_REPORT_INTERVAL * BEACON_TIMER_RESOLUTION);
  log_expf("    Legacy adv interval:      %x-%x ms\r\n",
      BEACON_ADV_MIN_INTERVAL, BEACON_ADV_MAX_INTERVAL);
  log_expf("    Periodic adv pkt size:    %u bytes\r\n", PER_ADV_SIZE);

  log_expf("    Flash page size, count:   %u B, %u\r\n",
      storage.page_size, storage.num_pages);
  log_expf("    Flash offset:             0x%0x\r\n", storage.map.config);
  log_expf("    Total size:               %u\r\n", storage.total_size);
  log_expf("    Test filter offset:       0x%0x\r\n", storage.map.test_filter);

  log_expf("    Test filter length:       %lu\r\n", storage.test_filter_size);
  log_expf("    Config offset:            0x%0x\r\n", storage.map.config);
  log_expf("    Stat offset:              0x%0x\r\n", storage.map.stat);

  log_expf("    Periodic interval:        %u\r\n", PER_ADV_INTERVAL);
  log_expf("    Min sync adv. interval:   %u\r\n", PER_ADV_MIN_INTERVAL);
  log_expf("    Max sync adv. interval:   %u\r\n", PER_ADV_MAX_INTERVAL);
  log_expf("    Tx power:                 %u\r\n", PER_TX_POWER);

#ifdef MODE__STAT
  log_infof("%s", "    Statistics mode enabled\r\n");
#endif
}

#ifdef MODE__STAT
beacon_stats_t stats;

void beacon_stats_reset()
{
  memset(&stats, 0, sizeof(beacon_stats_t));
}

void beacon_stats_update()
{
  uint16_t tx_packets;
  uint16_t rx_packets;
  uint16_t crc_errors;
  uint16_t failures;

  /*
   * log hardware counters
   */
  sl_bt_system_get_counters(1, &tx_packets, &rx_packets,
      &crc_errors, &failures);

  stats.total_packets_sent += (uint32_t) tx_packets;
  stats.crc_errors += (uint32_t) crc_errors;
  stats.failures += (uint32_t) failures;
}

static void beacon_stats_print()
{
  log_expf("[%lu] last report time: %lu #epochs: %u chksum: %u\r\n",
      beacon_time, stats.start, stats.epochs, stats.storage_checksum);
  log_expf("sent broadcast packets: %u, total sent packets: %u, "
		  "crc errors: %u, failures: %u\r\n",
		  stats.sent_broadcast_packets, stats.total_packets_sent,
		  stats.crc_errors, stats.failures);
  stat_show(stats.broadcast_payload_update_duration,
      "[broadcast payload] Update duration", "ms");
}

#endif

static void _beacon_report_()
{
#ifdef MODE__STAT
  if (beacon_time - stats.start < BEACON_REPORT_INTERVAL)
    return;

  beacon_stats_update();
  beacon_stats_print();
  beacon_storage_save_stat(&storage, &config, &stats, sizeof(beacon_stats_t));
//  beacon_stats_reset();
//  stat_epochs = 1;
  stats.start = beacon_time;
#endif
}

void beacon_reset_counters()
{
  sl_bt_system_get_counters(1, 0, 0, 0, 0);
}

// Set transmission power (zephyr).
// Yoinked from (https://github.com/zephyrproject-rtos/zephyr/blob/main/samples/bluetooth/hci_pwr_ctrl/src/main.c)


// Intermediary transformer to create a well-formed BT data type
// for using the high-level APIs. Becomes obsolete once advertising
// routine supports a full raw payload
static void _form_payload_()
{
  const size_t len = ENCOUNTER_BROADCAST_SIZE - 1;
#define bt (payload.bt_data)
  uint8_t tmp;
  tmp = bt->data_len;
  bt->data_len = bt->type;
  bt->type = tmp;
  tmp = bt->data_len;
  bt->data_len = len;
#define en (payload.en_data)
  en.bytes[MAX_BROADCAST_SIZE - 1] = tmp;
#undef en
#undef bt
}

// pack a raw byte payload by copying from the high-level type
// order is important here so as to avoid unaligned access on the
// receiver side
static void _encode_encounter_()
{
  uint8_t *dst = (uint8_t *) &payload.en_data;
  size_t pos = 0;
#define copy(src, size)           \
  memcpy(dst + pos, src, size); \
  pos += size
  copy(&beacon_time, sizeof(beacon_timer_t));
  copy(&config.beacon_id, sizeof(beacon_id_t));
  copy(&config.beacon_location_id, sizeof(beacon_location_id_t));
  copy(&beacon_eph_id, sizeof(beacon_eph_id_t));
#undef copy
  hexdumpen(beacon_eph_id.bytes, BEACON_EPH_ID_HASH_LEN, "eph ID",
      config.beacon_id, (uint32_t) config.beacon_location_id, 0,
      (uint32_t) beacon_time, 0, (uint32_t) 0, 0, 0, (uint32_t) 0);
}

static void _beacon_encode_()
{
  // Load broadcast into bluetooth payload
  _encode_encounter_();
  _form_payload_();
}

static void _gen_ephid_()
{
  hash_t h;
  digest_t d;
#define init() sha_256_init(&h, d.bytes)
#define add(data, size) sha_256_write(&h, data, size)
#define complete() sha_256_close(&h)

  // Initialize hash
  init();
  // Add relevant data
  add(config.beacon_sk, config.beacon_sk_size);
  add(&config.beacon_location_id, sizeof(beacon_location_id_t));
  add(&epoch, sizeof(beacon_epoch_counter_t));
  // finalize and copy to id
  complete();
  memcpy(&beacon_eph_id, &d, BEACON_EPH_ID_HASH_LEN); // Little endian so these are the least significant
#undef complete
#undef add
#undef init
}

static void beacon_stats_init()
{
#ifdef MODE__STAT
  stats.epochs = 1;
  stats.start = beacon_time;
  beacon_storage_read_stat(&storage, &stats, sizeof(beacon_stats_t));
  if (!stats.storage_checksum) {
    log_infof("%s", "Existing Statistics Found\r\n");
    beacon_stats_print();
  } else {
    log_errorf("init stats checksum: 0x%0x\r\n", stats.storage_checksum);
    beacon_stats_reset();
  }
#endif
#if MODE__SL_BEACON_TEST_CONFIG
  beacon_stats_reset();
  beacon_storage_save_stat(&storage, &config, &stats, sizeof(beacon_stats_t));
#endif
}

static void _beacon_epoch_()
{
  static beacon_epoch_counter_t old_epoch;
  old_epoch = epoch;
  epoch = epoch_i(beacon_time, config.t_init);
  if (!cycles || epoch != old_epoch) {
    log_debugf("EPOCH STARTED: %u\r\n", epoch);
    // When a new epoch has started, generate a new ephemeral id
    _gen_ephid_();
    if (epoch != old_epoch) {
#ifdef MODE__STAT
      stats.epochs++;
#endif
    }
    // TODO: log time to flash
  }
}

int _set_adv_data_()
{
  log_debugf("%s", "Setting legacy adv data...\r\n");
//  print_bytes(payload.en_data.bytes, MAX_BROADCAST_SIZE, "adv_data");
  sl_status_t sc = sl_bt_advertiser_set_data(legacy_set_handle,
      0, 31, payload.en_data.bytes);
  if (sc != 0) {
    log_errorf("Error, sc: 0x%lx\r\n", sc);
    return -1;
  }

  stats.sent_broadcast_packets++;

  log_debugf("%s", "Success!\r\n");
  return 0;
}

sl_status_t beacon_legacy_advertise()
{
  sl_status_t sc;
  log_debugf("%s", "Creating legacy advertising set\r\n");
  sc = sl_bt_advertiser_create_set(&legacy_set_handle);
  if (sc != 0) {
    log_errorf("Error, sc: 0x%lx\r\n", sc);
    return sc;
  }

  // Set Power Level
  int16_t set_power;
  sc = sl_bt_advertiser_set_tx_power(legacy_set_handle,
      LEGACY_TX_POWER, &set_power);

  log_expf("=== Starting legacy advertising... Tx power: %d ===\r\n", set_power);
  // Set advertising interval to 100ms.
  sc = sl_bt_advertiser_set_timing(legacy_set_handle,
      BEACON_ADV_MIN_INTERVAL, // min. adv. interval (milliseconds * 1.6)
      BEACON_ADV_MAX_INTERVAL, // max. adv. interval (milliseconds * 1.6) next: 0x4000
      0,                       // adv. duration, 0 for continuous advertising
      0);                      // max. num. adv. events
  if (sc != 0) {
    log_errorf("Error, sc: 0x%lx\r\n", sc);
    return sc;
  }

  // Start legacy advertising
  sc = sl_bt_advertiser_start(legacy_set_handle, advertiser_user_data,
      advertiser_non_connectable);
  if (sc != 0) {
    log_errorf("Error starting advertising, sc: 0x%lx\r\n", sc);
    return sc;
  }

  return sc;
}

void beacon_on_clock_update()
{
  _beacon_epoch_();
  _beacon_encode_();
  _set_adv_data_();
}

int beacon_clock_increment(beacon_timer_t time)
{
  beacon_time += time;
  log_debugf("beacon timer: %u\r\n", beacon_time);

#if BEACON_MODE__NETWORK == 0
  beacon_on_clock_update();
#endif

  // update beacon time in config and save to flash
  config.t_cur = beacon_time;
  nvm3_save_clock_cursor(&storage, &config);
//  beacon_storage_save_config(&storage, &config);

  // update stats and save to flash
  cycles++;
  _beacon_report_();

  return 0;
}

/*
 * Initialize Pancast-specific beacon configs
 */
void beacon_init()
{
  log_debugf("%s", "Init beacon\r\n");

  beacon_load();
  beacon_info();

  epoch = 0;
  cycles = 0;

  beacon_time = config.t_cur > config.t_init ? config.t_cur : config.t_init;

  beacon_stats_init();

  configure_blinky();
}

beacon_storage *get_beacon_storage()
{
  return &storage;
}

void beacon_periodic_advertise()
{
  int sc = 0;

  /*
   * create an advertising set object
   */
  sc = sl_bt_advertiser_create_set(&advertising_set_handle);
  if (sc != 0) {
    log_errorf("error creating advertising set, sc: 0x%X", sc);
  }

#if 0
  /*
   * set PHY config
   */
  sc = sl_bt_advertiser_set_phy(advertising_set_handle,
      sl_bt_gap_1m_phy, sl_bt_gap_2m_phy);
  app_assert_status(sc);
#endif

  /*
   * set advertising power Level
   */
  int16_t set_power;
  sc = sl_bt_advertiser_set_tx_power(advertising_set_handle,
      PER_TX_POWER, &set_power);
  if (sc != 0) {
    log_errorf("error setting advertiser tx power, sc: 0x%X", sc);
  }

  /*
   * set advertising interval to 100ms.
   */
  sc = sl_bt_advertiser_set_timing(advertising_set_handle,
      PER_ADV_MIN_INTERVAL, // min. adv. interval (milliseconds * 1.6)
      PER_ADV_MAX_INTERVAL, // max. adv. interval (milliseconds * 1.6)
      NO_MAX_DUR,       // adv. duration
      NO_MAX_EVT);      // max. num. adv. events
  if (sc != 0) {
    log_errorf("Error setting channel map, sc: 0x%X", sc);
  }

  log_expf("=== Starting periodic advertising... Tx power: %d ===\r\n",
      set_power);

  sc = sl_bt_advertiser_start_periodic_advertising(
      advertising_set_handle, PER_ADV_INTERVAL, PER_ADV_INTERVAL,
      PER_FLAGS);

  if (sc != 0) {
    log_errorf("Error setting channel map, sc: 0x%X", sc);
  }
}

/*
 * Update risk data after receive from raspberry pi client
 */
void set_risk_data(int len, uint8_t *data)
{
  sl_status_t sc = 0;

  // cannot send more than PER_ADV_SIZE bytes at a time
  // we expect the caller to chunk the data into appropriate size
  if (len > PER_ADV_SIZE)
    return;

  sc = sl_bt_advertiser_set_data(advertising_set_handle, 8, len, data);
  if (sc != 0) {
    log_infof("[periodic adv] set data err, sc: 0x%lx\r\n", sc);
  }
}

#undef MODE__STAT
#undef APPL_VERSION
```

## src/beacon.h
```c
#ifndef BEACON__H
#define BEACON__H

#include <assert.h>

#include "sl_bluetooth.h"
#include "common/src/settings.h"
#include "common/src/util/stats.h"

/*
 * config to broadcast test risk data
 * 1 - test risk data
 * 0 - real risk data from backend
 */
#define PERIODIC_TEST   0

/*
 * 1 - init test config
 * 0 - load config from storage
 */
#define MODE__SL_BEACON_TEST_CONFIG  0

/*
 * config to enable periodic advertising in network beacon
 * 1 - enable periodic advertising
 * 0 - disable periodic advertising
 */
#define BEACON_MODE__NETWORK    1

// #define BEACON_GAEN_ENABLED

#include "common/src/constants.h"
#include "common/src/settings.h"
#include "common/src/test.h"
#include "./sha-2/sha-256.h"


typedef struct
{
  beacon_id_t beacon_id;                   // Beacon ID
  beacon_location_id_t beacon_location_id; // Location ID
  beacon_timer_t t_init;                   // Beacon initial clock
  beacon_timer_t t_cur;                    // Beacon current clock
  key_size_t backend_pk_size;              // Size of backend public key
  pubkey_t *backend_pk;                     // Backend public key
  key_size_t beacon_sk_size;               // Size of secret key
  beacon_sk_t *beacon_sk;                   // Secret Key
} beacon_config_t;

/*
 * beacon Tx power
 * units: 0.1 dbm, i.e.,
 * if min_tx_power = -3, power config is -0.3 dbm
 */
#define GLOBAL_TX_POWER 0
#define MIN_TX_POWER -10
#define MAX_TX_POWER 0 // device maximum is 8.5 dbm

/*
 * Advertising interval settings
 *
 * unit is 0.625 ms, i.e,
 * if min_interval = 0x320, actual interval is 500ms
 */
#define BEACON_ADV_MIN_INTERVAL 0x320 // 500ms
#define BEACON_ADV_MAX_INTERVAL 0x640 // 1000ms
#define LEGACY_TX_POWER GLOBAL_TX_POWER

/* Periodic Advertising */
#define PER_ADV_HANDLE 0xff
#define PER_ADV_MIN_INTERVAL 0x20  // min. adv. interval (milliseconds * 1.6)
#define PER_ADV_MAX_INTERVAL 0x20  // max. adv. interval (milliseconds * 1.6)
#define PER_ADV_INTERVAL 10    // per. adv. interval (units of 1.25ms)
#define PER_FLAGS 0            // no periodic advertising flags
#define PER_TX_POWER GLOBAL_TX_POWER

/* Timers */
#define LED_TIMER_MS 2000 // one second in ms, used for timer
#define MAIN_TIMER_HANDLE 0
#define MAIN_TIMER_PRIORT 1

typedef struct
{
  uint8_t bytes[32];
} digest_t;

typedef struct Sha_256 hash_t;

typedef struct
{
  uint8_t data_len;
  uint8_t type;
  uint8_t data[29];
} bt_data_t;

typedef union
{
  encounter_broadcast_raw_t en_data;
  bt_data_t bt_data[1];
} bt_wrapper_t;

typedef union
{
  bt_data_t flags;
  bt_data_t serviceUUID;
  char service_data_internals[22];
} bt_gaen_wrapper_t;

typedef struct
{
  /*
   * zero for valid stat data
   */
  uint8_t storage_checksum;
  beacon_timer_t start;
  /*
   * total number of epochs elapsed
   */
  uint32_t epochs;
  /*
   * total number of legacy adv. packets sent
   */
  uint32_t sent_broadcast_packets;
  uint32_t total_packets_sent;
  uint32_t crc_errors;
  uint32_t failures;
  stat_t broadcast_payload_update_duration;
} beacon_stats_t;

extern beacon_stats_t stats;

void beacon_init();
void beacon_broadcast();
int _set_adv_data_();
void beacon_on_clock_update(void);
int beacon_clock_increment(beacon_timer_t time);
sl_status_t beacon_legacy_advertise();
void beacon_periodic_advertise();
void set_risk_data(int len, uint8_t *data);

#endif
```

## src/led.h
```c
#ifndef __LED_H__
#define __LED_H__

#include "sl_simple_led_instances.h"
#include "sl_bluetooth.h"

#define LOG_LEVEL__INFO

#include "src/common/src/util/log.h"

extern const sl_led_t sl_led_led0;
extern sl_sleeptimer_timer_handle_t led_timer;

static inline void beacon_led_timer_handler(
    __attribute__ ((unused)) sl_sleeptimer_timer_handle_t *handle,
    __attribute__ ((unused)) void *data)
{
  sl_led_toggle(SL_SIMPLE_LED_INSTANCE(0));
}

/*
 * technically, this function is not required.
 * sl_simple_led_init_instances() is already called from sl_driver_init().
 * it is added there by the sdk when adding LED component to the project.
 */
static inline void configure_blinky(void)
{
  sl_simple_led_init_instances();
  sl_simple_led_context_t *ctx = sl_led_led0.context;
  sl_sleeptimer_start_periodic_timer_ms(&led_timer, LED_TIMER_MS,
      beacon_led_timer_handler, (void *) NULL, 0, 0);
  log_expf("Config LED port %d pin %d polarity %d\r\n", ctx->port,
      ctx->pin, ctx->polarity);
}

#endif /* __LED_H__ */
```

## src/nvm3_lib.c
```c
/***************************************************************************//**
 * @file
 * @brief NVM3 examples functions
 *******************************************************************************
 * # License
 * <b>Copyright 2020 Silicon Laboratories Inc. www.silabs.com</b>
 *******************************************************************************
 *
 * The licensor of this software is Silicon Laboratories Inc. Your use of this
 * software is governed by the terms of Silicon Labs Master Software License
 * Agreement (MSLA) available at
 * www.silabs.com/about-us/legal/master-software-license-agreement. This
 * software is distributed to you in Source Code format and is governed by the
 * sections of the MSLA applicable to Source Code.
 *
 ******************************************************************************/
#include <stdio.h>
#include <string.h>

#include "nvm3_lib.h"
#include "nvm3_default.h"
#include "nvm3_default_config.h"
#include "common/src/util/log.h"

/*******************************************************************************
 **************************   LOCAL VARIABLES   ********************************
 ******************************************************************************/

enum {
//  NVM3_CNT_BEACON_ID = 0,
//  NVM3_CNT_T_INIT,
  NVM3_CNT_T_CUR = 0,
//  NVM3_CNT_BKND_PK_SIZE,
//  NVM3_CNT_BEACON_SK_SIZE,
  NVM3_MAX_COUNTERS
};

// Max and min keys for data objects
#define MIN_DATA_KEY  NVM3_KEY_MIN
#define MAX_DATA_KEY  (MIN_DATA_KEY + NVM3_MAX_COUNTERS - 1)

/*******************************************************************************
 **************************   GLOBAL FUNCTIONS   *******************************
 ******************************************************************************/

/***************************************************************************//**
 * Delete all data in NVM3.
 *
 * It deletes all data stored in NVM3.s
 ******************************************************************************/
void nvm3_app_reset(void *arguments)
{
  (void)&arguments;
//  printf("Deleting all data stored in NVM3\r\n");
  nvm3_eraseAll(NVM3_DEFAULT_HANDLE);
  // This deletes the counters, too, so they must be re-initialised
//  initialise_counters();
}

/***************************************************************************//**
 * Initialize NVM3 example.
 ******************************************************************************/
void nvm3_app_init(void)
{
  Ecode_t err;

  // This will call nvm3_open() with default parameters for
  // memory base address and size, cache size, etc.
  err = nvm3_initDefault();
  EFM_ASSERT(err == ECODE_NVM3_OK);
}

size_t nvm3_count_objects(void)
{
  nvm3_ObjectKey_t keys[NVM3_MAX_COUNTERS];
  memset(keys, 0, sizeof(nvm3_ObjectKey_t) * NVM3_MAX_COUNTERS);

  size_t nvm3_objcnt = nvm3_enumObjects(NVM3_DEFAULT_HANDLE, (uint32_t *) keys,
      sizeof(keys)/sizeof(keys[0]), MIN_DATA_KEY, MAX_DATA_KEY);

#if LOG_LVL == LVL_DBG
  size_t i, len;
  uint32_t type;
  for (i = 0; i < nvm3_cnt; i++) {
    nvm3_getObjectInfo(NVM3_DEFAULT_HANDLE, keys[i], &type, &len);
    log_expf("[NVM:%d] type: 0x%0x len: %u\r\n", i, type, len);
  }
#endif

  return nvm3_objcnt;

//  return nvm3_countObjects(NVM3_DEFAULT_HANDLE);
}

size_t nvm3_get_erase_count(void)
{
  uint32_t erasecnt = 0;
  Ecode_t err = nvm3_getEraseCount(NVM3_DEFAULT_HANDLE, &erasecnt);
  if (err != ECODE_NVM3_OK) {
    log_expf("cnt: %u err: 0x%0x\r\n", erasecnt, err);
    return 0;
  }

  return erasecnt;
}

void nvm3_save_config(beacon_storage *sto, beacon_config_t *cfg)
{
  Ecode_t err[NVM3_MAX_COUNTERS];
  int i = 0;
#define nvm3_write(cntr_id, val)  \
  err[i++] = nvm3_writeCounter(NVM3_DEFAULT_HANDLE, cntr_id, val)

//  nvm3_write(NVM3_CNT_BEACON_ID, cfg->id);
//  nvm3_write(NVM3_CNT_T_INIT, cfg->t_init);
  nvm3_write(NVM3_CNT_T_CUR, cfg->t_cur);
//  nvm3_write(NVM3_CNT_BKND_PK_SIZE, cfg->backend_pk_size);
//  nvm3_write(NVM3_CNT_BEACON_SK_SIZE, cfg->beacon_sk_size);

  log_expf("[NVM3] Tc: %u errs: 0x%0x\r\n", cfg->t_cur, err[0]);
#if 0
  log_infof("[NVM3] ID: 0x%0x T0: %u Tc: %u PK: %u SK: %u H: %u T: %u, "
      "errs: 0x%0x 0x%0x 0x%0x 0x%0x 0x%0x 0x%0x 0x%0x\r\n",
      cfg->id, cfg->t_init, cfg->t_cur, cfg->backend_pk_size,
      cfg->beacon_sk_size,
      err[0], err[1], err[2], err[3], err[4]);
#endif

#undef nvm3_write
}

void nvm3_save_clock_cursor(beacon_storage *sto, beacon_config_t *cfg)
{
  Ecode_t err[NVM3_MAX_COUNTERS];
  int i = 0;
#define nvm3_write(cntr_id, val)  \
  err[i++] = nvm3_writeCounter(NVM3_DEFAULT_HANDLE, cntr_id, val)

  nvm3_write(NVM3_CNT_T_CUR, cfg->t_cur);

  log_infof("[NVM3] Tc: %u errs: 0x%0x\r\n",
      cfg->t_cur, err[0]);

#undef nvm3_write
}

void nvm3_load_config(__attribute__((unused)) beacon_storage *sto,
    __attribute__((unused)) beacon_config_t *cfg)
{
  Ecode_t err[NVM3_MAX_COUNTERS];
  uint32_t val[NVM3_MAX_COUNTERS];
  int i = 0, j = 0;

#define nvm3_read(cntr_id, valp)  \
  err[i++] = nvm3_readCounter(NVM3_DEFAULT_HANDLE, cntr_id, valp)

//  nvm3_read(NVM3_CNT_BEACON_ID, &val[j++]);
//  nvm3_read(NVM3_CNT_T_INIT, &val[j++]);
  nvm3_read(NVM3_CNT_T_CUR, &val[j++]);
//  nvm3_read(NVM3_CNT_BKND_PK_SIZE, &val[j++]);
//  nvm3_read(NVM3_CNT_BEACON_SK_SIZE, &val[j++]);

  log_expf("[NVM3] Tc: %u errs: 0x%0x\r\n", val[0], err[0]);
  cfg->t_cur = val[NVM3_CNT_T_CUR];

#if 0
  log_expf("[NVM3] ID: 0x%0x T0: %u Tc: %u PK: %u SK: %u H: %u T: %u, "
      "errs: 0x%0x 0x%0x 0x%0x 0x%0x 0x%0x 0x%0x 0x%0x\r\n",
      val[0], val[1], val[2], val[3], val[4],
      err[0], err[1], err[2], err[3], err[4]);
#endif

#undef nvm3_read
}

/***************************************************************************//**
 * NVM3 ticking function.
 ******************************************************************************/
void nvm3_app_process_action(void)
{
  // Check if NVM3 controller can release any out-of-date objects
  // to free up memory.
  // This may take more than one call to nvm3_repack()
  while (nvm3_repackNeeded(NVM3_DEFAULT_HANDLE)) {
    log_infof("Repacking NVM...\r\n");
    nvm3_repack(NVM3_DEFAULT_HANDLE);
  }
}
```

## src/nvm3_lib.h
```c
/***************************************************************************//**
 * @file
 * @brief NVM3 examples functions
 *******************************************************************************
 * # License
 * <b>Copyright 2020 Silicon Laboratories Inc. www.silabs.com</b>
 *******************************************************************************
 *
 * The licensor of this software is Silicon Laboratories Inc. Your use of this
 * software is governed by the terms of Silicon Labs Master Software License
 * Agreement (MSLA) available at
 * www.silabs.com/about-us/legal/master-software-license-agreement. This
 * software is distributed to you in Source Code format and is governed by the
 * sections of the MSLA applicable to Source Code.
 *
 ******************************************************************************/

#ifndef __NVM3_LIB_H__
#define __NVM3_LIB_H__

#include "beacon.h"
#include "storage.h"

/*******************************************************************************
 *******************************   DEFINES   ***********************************
 ******************************************************************************/

// Use the default nvm3 handle from nvm3_default.h
#define NVM3_DEFAULT_HANDLE nvm3_defaultHandle

/***************************************************************************//**
 * Initialize NVM3 example
 ******************************************************************************/
void nvm3_app_init(void);

size_t nvm3_count_objects(void);
size_t nvm3_get_erase_count(void);
void nvm3_save_config(beacon_storage *sto, beacon_config_t *cfg);
void nvm3_save_clock_cursor(beacon_storage *sto, beacon_config_t *cfg);
void nvm3_load_config(beacon_storage *sto, beacon_config_t *cfg);

/***************************************************************************//**
 * NVM3 ticking function
 ******************************************************************************/
void nvm3_app_process_action(void);

#endif  // __NVM3_LIB_H__
```

## src/storage.c
```c
#define LOG_LEVEL__INFO

#include "storage.h"

#include <string.h>

#include "common/src/platform/gecko.h"
#include "common/src/util/log.h"
#include "common/src/util/util.h"

#define next_multiple(k, n) ((n) + ((k) - ((n) % (k)))) // buggy

void beacon_storage_erase(beacon_storage *sto, storage_addr_t offset)
{
  log_debugf("erasing page at 0x%x\r\n", (offset));
  MSC_ErasePage((uint32_t *)offset);
  log_debugf("%s", "erased.\r\n");
  sto->numErasures++;
}

void pre_erase(beacon_storage *sto, storage_addr_t off, size_t write_size)
{
  // Erase before write
#define page_num(o) ((o) / sto->page_size)
  if ((off % sto->page_size) == 0) {
    beacon_storage_erase(sto, off);
  } else if (page_num(off + write_size) > page_num(off)) {
    beacon_storage_erase(sto, next_multiple(sto->page_size, off));
  }
#undef page_num
}

int _flash_read_(__attribute__((unused)) beacon_storage *sto, storage_addr_t off,
    void *data, size_t size)
{
  log_debugf("size: %d bytes, addr: 0x%x, flash off: 0x%0x\r\n",
      size, off, sto->map.config);
  memcpy(data, (uint32_t *) off, size);
  return 0;
}

int _flash_write_(__attribute__((unused)) beacon_storage *sto, storage_addr_t off,
    void *data, size_t size)
{
  log_debugf("size: %d bytes, addr: 0x%x, flash off: 0x%0x\r\n",
      size, off, sto->map.config);
  return MSC_WriteWord((uint32_t *) off, data, (uint32_t) size);
}

void beacon_storage_get_info(beacon_storage *sto)
{
  sto->num_pages = FLASH_DEVICE_NUM_PAGES;
  sto->min_block_size = FLASH_DEVICE_BLOCK_SIZE;
  sto->page_size = FLASH_DEVICE_PAGE_SIZE;
  sto->total_size = sto->num_pages * sto->page_size;
}

void beacon_storage_init_device(beacon_storage *sto)
{
  MSC_ExecConfig_TypeDef execConfig = MSC_EXECCONFIG_DEFAULT;
  sto->mscExecConfig = execConfig;
  MSC_ExecConfigSet(&sto->mscExecConfig);
  MSC_Init();
}

void beacon_storage_init(beacon_storage *sto)
{
  log_debugf("%s", "Initializing storage...\r\n");
  sto->numErasures = 0;
  beacon_storage_init_device(sto);
  beacon_storage_get_info(sto);
  sto->map.config = FLASH_OFFSET;
  if (FLASH_OFFSET % sto->page_size != 0) {
    log_errorf("storage start addr %u is not page (%u) aligned!\r\n",
        FLASH_OFFSET, sto->page_size);
  }
//  sto->map.stat = sto->total_size - (3*sto->page_size);
}

// Read data from flashed storage
// Format matches the fixed structure which is also used as a protocol when appending non-app
// data to the device image.
void beacon_storage_load_config(beacon_storage *sto, beacon_config_t *cfg)
{
  log_debugf("%s", "Loading config...\r\n");
  storage_addr_t off = sto->map.config;
#define read(size, dst) (_flash_read_(sto, off, dst, size), off += size)
  read(sizeof(beacon_id_t), &cfg->beacon_id);
  read(sizeof(beacon_location_id_t), &cfg->beacon_location_id);
  read(sizeof(beacon_timer_t), &cfg->t_init);
  read(sizeof(key_size_t), &cfg->backend_pk_size);
  log_debugf("bknd key off: 0x%0x, size: %u\r\n", off, cfg->backend_pk_size);
  if (cfg->backend_pk_size > PK_MAX_SIZE) {
    log_errorf("Key size read for backend pubkey (%u > %u)\r\n",
        cfg->backend_pk_size, PK_MAX_SIZE);
    cfg->backend_pk_size = PK_MAX_SIZE;
  }

  read(cfg->backend_pk_size, cfg->backend_pk);
  hexdumpn(cfg->backend_pk->bytes, 16, "   Server PK");
  // slide through the extra space for a pubkey
  off += PK_MAX_SIZE - cfg->backend_pk_size;

  read(sizeof(key_size_t), &cfg->beacon_sk_size);
  log_debugf("beacon key off: 0x%0x, size: %u\r\n", off, cfg->beacon_sk_size);
  if (cfg->beacon_sk_size > SK_MAX_SIZE) {
    log_errorf("Key size read for beacon privkey (%u > %u)\r\n",
        cfg->beacon_sk_size, SK_MAX_SIZE);
    cfg->beacon_sk_size = SK_MAX_SIZE;
  }
  read(cfg->beacon_sk_size, cfg->beacon_sk);
  hexdumpn(cfg->beacon_sk->bytes, 16, "Si Beacon SK");
  // slide through the extra space for a pubkey
  off += SK_MAX_SIZE - cfg->beacon_sk_size;

  read(sizeof(test_filter_size_t), &sto->test_filter_size);

#if MODE__SL_BEACON_TEST_CONFIG
  if (sto->test_filter_size != TEST_FILTER_LEN) {
      log_errorf("Test filter length mismatch (%u != %u)\r\n",
          sto->test_filter_size, TEST_FILTER_LEN);
      sto->test_filter_size = TEST_FILTER_LEN;
  }
#endif

  sto->map.test_filter = off;

  /*
   * place stats on a separate page that can be repeatedly erased
   * and written to in order to ensure persistence of stats correctly.
   */
  sto->map.stat = next_multiple(sto->page_size,
      sto->map.test_filter + sto->test_filter_size);
  off = sto->map.stat;
  read(sizeof(beacon_timer_t), &cfg->t_cur);
#undef read
}

void beacon_storage_save_config(beacon_storage *sto, beacon_config_t *cfg)
{
  storage_addr_t off = sto->map.config;
  int total_size = sizeof(beacon_config_t) +
    sizeof(pubkey_t) + sizeof(beacon_sk_t) +
    sizeof(test_filter_size_t);

  // erase from the beginning of config page
  pre_erase(sto, off, total_size);

#define write(data, size) \
  (_flash_write_(sto, off, data, size), off += size)

  /*
   * write config to flash
   *
   * XXX: for some reason, using write(cfg, sizeof(beacon_config_t))
   * does not store the config correctly to flash.
   */
  write(&cfg->beacon_id, sizeof(beacon_id_t));
  write(&cfg->beacon_location_id, sizeof(beacon_location_id_t));
  write(&cfg->t_init, sizeof(beacon_timer_t));
  write(&cfg->backend_pk_size, sizeof(key_size_t));
  write(cfg->backend_pk, cfg->backend_pk_size);
  off += PK_MAX_SIZE - cfg->backend_pk_size;
  write(&cfg->beacon_sk_size, sizeof(key_size_t));
  write(cfg->beacon_sk, cfg->beacon_sk_size);
  off += SK_MAX_SIZE - cfg->beacon_sk_size;

  // write test filter len
  write(&sto->test_filter_size, sizeof(test_filter_size_t));

}


void beacon_storage_save_stat(beacon_storage *sto, beacon_config_t *cfg,
    void *stat, size_t len)
{
  beacon_storage_erase(sto, sto->map.stat);
  storage_addr_t off = sto->map.stat;
  _flash_write_(sto, off, &cfg->t_cur, sizeof(beacon_timer_t));
  off += sizeof(beacon_timer_t);
  _flash_write_(sto, off, stat, len);
}

void beacon_storage_read_stat(beacon_storage *sto, void *stat, size_t len)
{
  _flash_read_(sto, sto->map.stat, stat, len);
}

void beacon_storage_read_test_filter(beacon_storage *sto, uint8_t *buf)
{
  _flash_read_(sto, sto->map.test_filter, buf, sto->test_filter_size);
}

#undef next_multiple
```

## src/storage.h
```c
#ifndef STORAGE__H
#define STORAGE__H

//#define VERBOSE_DEBUG_LOGGING

// Non-Volatile storage
// Defines a simple API to read and write specific data structures
// with minimal coupling the underlying drivers.

#include "beacon.h"
#include "common/src/test.h"

#include <stddef.h>

// Offset determines a safe point of read/write beyond the pages used by application
// binaries. For now, determined empirically by doing a compilation pass then adjusting
// the value
#define FLASH_OFFSET 0x60000

#include "em_msc.h"
typedef uint32_t storage_addr_t;

typedef struct
{
  storage_addr_t config;  // address of device configuration
  storage_addr_t test_filter; // test cuckoo filter
  storage_addr_t stat;    // address of saved statistics
} _beacon_storage_map_;

typedef struct
{
  MSC_ExecConfig_TypeDef mscExecConfig;
  size_t min_block_size;
  int num_pages;
  size_t page_size;
  storage_addr_t total_size;
  _beacon_storage_map_ map;
  uint64_t numErasures;
  test_filter_size_t test_filter_size;
} beacon_storage;

// STORAGE INIT
// Should initialize the internal storage representation,
// including system-level information. Application configs like
// the storage map are left partially uninitialized.
// This allows *load_config* to be used.
void beacon_storage_init(beacon_storage *sto);

// LOAD CONFIG
// Should load application configuration data into the provided
// container, and set the map to allow load_otp to be used.
void beacon_storage_load_config(beacon_storage *sto, beacon_config_t *cfg);
void beacon_storage_save_config(beacon_storage *sto, beacon_config_t *cfg);

void beacon_storage_save_stat(beacon_storage *sto, beacon_config_t *cfg,
    void * stat, size_t len);
void beacon_storage_read_stat(beacon_storage *sto, void * stat, size_t len);
void beacon_storage_read_test_filter(beacon_storage *sto, uint8_t *buf);

#endif
```
