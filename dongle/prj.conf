## CMakeLists.txt
```
# Find Zephyr. This also loads Zephyr's build system.
cmake_minimum_required(VERSION 3.13.1)
find_package(Zephyr)
project(pancase_dongle)


# Add your source file to the "app" target. This must come after
# find_package(Zephyr) which defines the target.
target_sources(app PRIVATE src/dongle.c)
target_sources(app PRIVATE src/storage.c)
target_sources(app PRIVATE src/encounter.c)
target_sources(app PRIVATE src/access.c)
```

## prj.conf
```kconfig
CONFIG_BT=y
CONFIG_BT_CENTRAL=y
#CONFIG_BT_DEBUG_LOG=y
CONFIG_BT_DEVICE_NAME="PanCast Test Dongle"
CONFIG_FLASH=y
CONFIG_BT_PERIPHERAL=y
CONFIG_BT_SMP=y
CONFIG_BT_BAS=y
CONFIG_BT_GATT_CLIENT=y
```

## src/access.c
```c
#include "./access.h"

#include <string.h>

#ifdef DONGLE_PLATFORM__ZEPHYR
#include <stdio.h>
#include <bluetooth/conn.h>
#include <bluetooth/gatt.h>
#else
#include "sl_bluetooth.h"
#endif

#include "encounter.h"
#include "storage.h"

#define LOG_LEVEL__INFO
#include "common/src/util/log.h"
#include "common/src/util/util.h"

// Memory
#ifdef DONGLE_PLATFORM__ZEPHYR
struct k_mutex state_mu;
#endif
interact_state state;
uint8_t dongle_state;
enctr_entry_counter_t num_recs;
enctr_entry_counter_t next_rec = 0;
dongle_encounter_entry send_en;

#ifdef DONGLE_PLATFORM__ZEPHYR
static const struct bt_data ad[] = {
    BT_DATA_BYTES(BT_DATA_UUID128_ALL,
                  DONGLE_SERVICE_UUID)};
#endif

// STATES
#define DONGLE_UPLOAD_STATE_LOCKED 0x01
#define DONGLE_UPLOAD_STATE_UNLOCKED 0x02
#define DONGLE_UPLOAD_STATE_SEND_DATA_0 0x03
#define DONGLE_UPLOAD_STATE_SEND_DATA_1 0x04
#define DONGLE_UPLOAD_STATE_SEND_DATA_2 0x05
#define DONGLE_UPLOAD_STATE_SEND_DATA_3 0x06
#define DONGLE_UPLOAD_STATE_SEND_DATA_4 0x07

#ifdef DONGLE_PLATFORM__ZEPHYR
struct bt_conn *terminal_conn = NULL;
static struct bt_uuid_128 SERVICE_UUID = BT_UUID_INIT_128(DONGLE_SERVICE_UUID);
static struct bt_uuid_128 CHARACTERISTIC_UUID = BT_UUID_INIT_128(DONGLE_CHARACTERISTIC_UUID);
static struct bt_uuid_128 uuid = BT_UUID_INIT_128(0);
static struct bt_gatt_discover_params discover_params;
static struct bt_gatt_subscribe_params subscribe_params;

BT_GATT_SERVICE_DEFINE(dongle_service,
                       // 0. Primary Service Attribute
                       BT_GATT_PRIMARY_SERVICE(BT_UUID_DECLARE_128(DONGLE_SERVICE_UUID)),
                       // 1. Interaction Data
                       BT_GATT_CHARACTERISTIC(BT_UUID_DECLARE_128(DONGLE_CHARACTERISTIC_UUID), BT_GATT_CHRC_NOTIFY | BT_GATT_CHRC_WRITE, (BT_GATT_PERM_READ | BT_GATT_PERM_WRITE), NULL, NULL, &state),
                       // 2. CCC
                       BT_GATT_CCC(NULL, BT_GATT_PERM_READ | BT_GATT_PERM_WRITE),
                       //
);

static uint8_t _notify_(struct bt_conn *conn,
                        struct bt_gatt_subscribe_params *params,
                        const void *data, uint16_t length)
{
    if (!data)
    {
        log_info("[UNSUBSCRIBED]\r\n");
        params->value_handle = 0U;
        return BT_GATT_ITER_STOP;
    }

    log_debugf("[NOTIFICATION] data length %u\r\n", length);
    print_bytes(data, length, "Data");

    k_mutex_lock(&state_mu, K_FOREVER);
    memcpy(&state, data, sizeof(interact_state));
    k_mutex_unlock(&state_mu);

    interact_update();

    return BT_GATT_ITER_CONTINUE;
}

static uint8_t _discover_(struct bt_conn *conn,
                          const struct bt_gatt_attr *attr,
                          struct bt_gatt_discover_params *params)
{
    int err;

    if (!attr)
    {
        log_debug("Discover complete\r\n");
        (void)memset(params, 0, sizeof(*params));
        return BT_GATT_ITER_STOP;
    }

    log_debugf("[ATTRIBUTE] handle %u\r\n", attr->handle);

    if (!bt_uuid_cmp(discover_params.uuid, BT_UUID_DECLARE_128(DONGLE_SERVICE_UUID)))
    {
        uuid = CHARACTERISTIC_UUID;
        discover_params.uuid = &uuid.uuid;
        discover_params.start_handle = attr->handle + 1;
        discover_params.type = BT_GATT_DISCOVER_CHARACTERISTIC;

        err = bt_gatt_discover(conn, &discover_params);
        if (err)
        {
            log_errorf("Characteristic Discover failed (err %d)\r\n", err);
        }
    }
    else if (!bt_uuid_cmp(discover_params.uuid,
                          BT_UUID_DECLARE_128(DONGLE_CHARACTERISTIC_UUID)))
    {
        memcpy(&uuid, BT_UUID_GATT_CCC, sizeof(uuid));
        discover_params.uuid = &uuid.uuid;
        discover_params.start_handle = attr->handle + 2;
        discover_params.type = BT_GATT_DISCOVER_DESCRIPTOR;
        subscribe_params.value_handle = bt_gatt_attr_value_handle(attr);

        err = bt_gatt_discover(conn, &discover_params);
        if (err)
        {
            log_errorf("CCC Discover failed (err %d)\r\n", err);
        }
    }
    else
    {
        subscribe_params.notify = _notify_;
        subscribe_params.value = BT_GATT_CCC_NOTIFY;
        subscribe_params.ccc_handle = attr->handle;

        err = bt_gatt_subscribe(conn, &subscribe_params);
        if (err && err != -EALREADY)
        {
            log_errorf("Subscribe failed (err %d)\r\n", err);
        }
        else
        {
            log_info("[SUBSCRIBED]\r\n");
        }

        return BT_GATT_ITER_STOP;
    }

    return BT_GATT_ITER_STOP;
}
#endif

void interact_update()
{
#ifdef DONGLE_PLATFORM__ZEPHYR
    k_mutex_lock(&state_mu, K_FOREVER);
#else
    DONGLE_NO_OP;
#endif
    switch (dongle_state)
    {
    case DONGLE_UPLOAD_STATE_LOCKED:
        log_debug("Dongle is locked\r\n");
        if (state.flags == DONGLE_UPLOAD_DATA_TYPE_ACK_NUM_RECS)
        {
            log_debug("Ack for num recs received\r\n");
            break;
        }
        if (state.flags != DONGLE_UPLOAD_DATA_TYPE_OTP)
        {
            break;
        }
        log_debug("Checking code\r\n");
        dongle_lock();
        dongle_storage *storage = get_dongle_storage();
        int otp_idx = dongle_storage_match_otp(storage,
                                               *((dongle_otp_val *)state.otp.val));
        dongle_unlock();
        if (otp_idx > 0)
        {
            log_debug("Code checks out\r\n");
            dongle_lock();
            num_recs = dongle_storage_num_encounters_current(storage);
            if (num_recs == 0)
            {
                log_debug("No records, re-locking\r\n");
            }
            else
            {
                dongle_state = DONGLE_UPLOAD_STATE_UNLOCKED;
            }
            state.flags = DONGLE_UPLOAD_DATA_TYPE_NUM_RECS;
            memcpy(state.num_recs.val, &num_recs, sizeof(enctr_entry_counter_t));
            dongle_unlock();
            peer_update();
        }
        else
        {
            log_debug("bad code\r\n");
        }
        break;
    case DONGLE_UPLOAD_STATE_UNLOCKED:
    case DONGLE_UPLOAD_STATE_SEND_DATA_4:
        if (state.flags != DONGLE_UPLOAD_DATA_TYPE_ACK_NUM_RECS && state.flags != DONGLE_UPLOAD_DATA_TYPE_ACK_DATA_4)
        {
            break;
        }
        else if (state.flags == DONGLE_UPLOAD_DATA_TYPE_ACK_NUM_RECS)
        {
            log_debug("Ack for num recs received\r\n");
            log_info("Sending records...\r\n");
        }
        if (state.flags == DONGLE_UPLOAD_DATA_TYPE_ACK_DATA_4)
        {
            log_debug("Ack for d4 received\r\n");
            next_rec++;
        }

        if (next_rec >= num_recs)
        {
            log_info("All records sent\r\n");
            dongle_state = DONGLE_UPLOAD_STATE_LOCKED;
            next_rec = 0;
            break;
        }

        dongle_state = DONGLE_UPLOAD_STATE_SEND_DATA_0;

        // load next encounter
        dongle_storage_load_single_encounter(get_dongle_storage(), next_rec, &send_en);
        //_display_encounter_(&send_en);

        state.flags = DONGLE_UPLOAD_DATA_TYPE_DATA_0;
        memcpy(state.data.bytes, &send_en.beacon_id, sizeof(beacon_id_t));
        peer_update();
        break;
    case DONGLE_UPLOAD_STATE_SEND_DATA_0:
        if (state.flags != DONGLE_UPLOAD_DATA_TYPE_ACK_DATA_0)
        {
            break;
        }
        log_debug("Ack for d0 received\r\n");
        dongle_state = DONGLE_UPLOAD_STATE_SEND_DATA_1;

        state.flags = DONGLE_UPLOAD_DATA_TYPE_DATA_1;
        memcpy(state.data.bytes, &send_en.beacon_time, sizeof(beacon_timer_t));
        peer_update();
        break;
    case DONGLE_UPLOAD_STATE_SEND_DATA_1:
        if (state.flags != DONGLE_UPLOAD_DATA_TYPE_ACK_DATA_1)
        {
            break;
        }
        log_debug("Ack for d1 received\r\n");
        dongle_state = DONGLE_UPLOAD_STATE_SEND_DATA_2;

        state.flags = DONGLE_UPLOAD_DATA_TYPE_DATA_2;
        memcpy(state.data.bytes, &send_en.dongle_time, sizeof(dongle_timer_t));
        peer_update();
        break;
    case DONGLE_UPLOAD_STATE_SEND_DATA_2:
        if (state.flags != DONGLE_UPLOAD_DATA_TYPE_ACK_DATA_2)
        {
            break;
        }
        log_debug("Ack for d2 received\r\n");
        dongle_state = DONGLE_UPLOAD_STATE_SEND_DATA_3;

        state.flags = DONGLE_UPLOAD_DATA_TYPE_DATA_3;
        memcpy(state.data.bytes, send_en.eph_id.bytes, BEACON_EPH_ID_SIZE);
        peer_update();
        break;
    case DONGLE_UPLOAD_STATE_SEND_DATA_3:
        if (state.flags != DONGLE_UPLOAD_DATA_TYPE_ACK_DATA_3)
        {
            break;
        }
        log_debug("Ack for d3 received\r\n");
        dongle_state = DONGLE_UPLOAD_STATE_SEND_DATA_4;

        state.flags = DONGLE_UPLOAD_DATA_TYPE_DATA_4;
        memcpy(state.data.bytes, &send_en.location_id, sizeof(beacon_location_id_t));
        peer_update();
        break;
    default:
        log_errorf("No match for state! (%d)\r\n", dongle_state);
    }
#ifdef DONGLE_PLATFORM__ZEPHYR
    k_mutex_unlock(&state_mu);
#else
    DONGLE_NO_OP;
#endif
}

void peer_update()
{
#ifdef DONGLE_PLATFORM__ZEPHYR
    k_mutex_lock(&state_mu, K_FOREVER);
    bt_gatt_notify(NULL, &dongle_service.attrs[1], &state, sizeof(interact_state));
    k_mutex_unlock(&state_mu);
#else
    DONGLE_NO_OP;
#endif
}

#ifdef DONGLE_PLATFORM__ZEPHYR
static void _peer_connected_(struct bt_conn *conn, uint8_t err)
{
    if (err)
    {
        log_infof("Peer connection failed (err 0x%02x)\r\n", err);
    }
    else
    {
        log_info("Peer connected\r\n");
        if (terminal_conn == NULL)
        {
            terminal_conn = conn;
            uuid = SERVICE_UUID;
            discover_params.uuid = &uuid.uuid;
            discover_params.func = &_discover_;
            discover_params.start_handle = BT_ATT_FIRST_ATTTRIBUTE_HANDLE;
            discover_params.end_handle = BT_ATT_LAST_ATTTRIBUTE_HANDLE;
            discover_params.type = BT_GATT_DISCOVER_PRIMARY;

            err = bt_gatt_discover(terminal_conn, &discover_params);
            if (err)
            {
                log_errorf("Discover failed(err %d)\r\n", err);
                return;
            }
        }
    }
}

static void _peer_disconnected_(struct bt_conn *conn, uint8_t reason)
{
    log_infof("Peer disconnected (reason 0x%02x)\r\n", reason);
    terminal_conn = NULL;
    k_mutex_lock(&state_mu, K_FOREVER);
    dongle_state = DONGLE_UPLOAD_STATE_LOCKED;
    k_mutex_unlock(&state_mu);
}

static struct bt_conn_cb conn_callbacks = {
    .connected = _peer_connected_,
    .disconnected = _peer_disconnected_,
};

static void _peer_auth_cancel_(struct bt_conn *conn)
{
    char addr[BT_ADDR_LE_STR_LEN];

    bt_addr_le_to_str(bt_conn_get_dst(conn), addr, sizeof(addr));

    log_infof("Peer pairing cancelled: %s\r\n", addr);
}

static struct bt_conn_auth_cb auth_cb_display = {
    .cancel = _peer_auth_cancel_,
};
#endif

int access_advertise()
{

    dongle_state = DONGLE_UPLOAD_STATE_LOCKED;

#ifdef DONGLE_PLATFORM__ZEPHYR
    print_bytes(ad[0].data, ad[0].data_len, "ad data");
    int err = bt_le_adv_start(BT_LE_ADV_CONN_NAME, ad, ARRAY_SIZE(ad), NULL, 0);
    if (err)
    {
        log_infof("Advertising failed to start (err %d)\r\n", err);
        return err;
    }

    bt_conn_cb_register(&conn_callbacks);
    bt_conn_auth_cb_register(&auth_cb_display);

    // obtain and report adverisement address
    char addr_s[BT_ADDR_LE_STR_LEN];
    bt_addr_le_t addr = {0};
    size_t count = 1;

    bt_id_get(&addr, &count);
    bt_addr_le_to_str(&addr, addr_s, sizeof(addr_s));

    log_infof("ACCESS: Bluetooth advertising started with address %s\r\n", addr_s);
#else
    sl_status_t sc;
    uint8_t ad_handle = 0x00;
#define INTERVAL 160 // 100 ms per the example
    sc = sl_bt_advertiser_create_set(&ad_handle);
    if (sc) {
        log_errorf("error creating advertising set: 0x%x\r\n", sc);
        return sc;
    }
    sc = sl_bt_advertiser_set_timing(ad_handle,
        INTERVAL,
        INTERVAL, 0, 0);
    if (sc) {
        log_errorf("error setting advertising timing: 0x%x\r\n", sc);
        return sc;
    }
#undef INTERVAL
    sc = sl_bt_advertiser_start(ad_handle,
        advertiser_general_discoverable,
        advertiser_connectable_scannable);
    if (sc) {
        log_errorf("error starting advertising: 0x%x\r\n", sc);
        return sc;
    }
    log_info("Advertising started successfully\r\n");
#endif

    return 0;
}
```

## src/access.h
```c
#ifndef DONGLE_ACCESS__H
#define DONGLE_ACCESS__H

// TERMINAL INTERACTION
// This is a connection-oriented protocol for external upload
// through a user-interface device. Dongle acts as the peripheral
// and accepts connections while proceeding with normal operation.
// Only the 'delayed-release' mechanism is supported right now.
// Data is currently unencrypted when sent to the terminal.

#include <stdint.h>

#include "dongle.h"
#include "storage.h"

// SERVICE UUID: e7f72a03-803b-410a-98d4-4be5fad8e217
#define DONGLE_INTERACT_SERVICE_ID_0 0xe7f72a03
#define DONGLE_INTERACT_SERVICE_ID_1 0x803b
#define DONGLE_INTERACT_SERVICE_ID_2 0x410a
#define DONGLE_INTERACT_SERVICE_ID_3 0x98d4
#define DONGLE_INTERACT_SERVICE_ID_4 0x4be5fad8e217

// Macro for expressing indexed UUIDS for use in the access protocol
// These are based on the primary service ID (index 0) and support
// a large number of IDs - assuming that the 6-byte part of the base
// UUID is well below the max val.
#ifdef DONGLE_PLATFORM__ZEPHYR
#define DONGLE_INTERACT_UUID(i) BT_UUID_128_ENCODE( \
    DONGLE_INTERACT_SERVICE_ID_0,                   \
    DONGLE_INTERACT_SERVICE_ID_1,                   \
    DONGLE_INTERACT_SERVICE_ID_2,                   \
    DONGLE_INTERACT_SERVICE_ID_3,                   \
    DONGLE_INTERACT_SERVICE_ID_4 + i)
#else
#define DONGLE_INTERACT_UUID(i) DONGLE_NO_OP, 0;
#endif

#define DONGLE_SERVICE_UUID DONGLE_INTERACT_UUID(0)

#define DONGLE_CHARACTERISTIC_UUID DONGLE_INTERACT_UUID(1)

// Data types
#define DONGLE_UPLOAD_DATA_TYPE_OTP 0x01
#define DONGLE_UPLOAD_DATA_TYPE_NUM_RECS 0x02
#define DONGLE_UPLOAD_DATA_TYPE_ACK_NUM_RECS 0x03
#define DONGLE_UPLOAD_DATA_TYPE_DATA_0 0x04
#define DONGLE_UPLOAD_DATA_TYPE_ACK_DATA_0 0x05
#define DONGLE_UPLOAD_DATA_TYPE_DATA_1 0x06
#define DONGLE_UPLOAD_DATA_TYPE_ACK_DATA_1 0x07
#define DONGLE_UPLOAD_DATA_TYPE_DATA_2 0x08
#define DONGLE_UPLOAD_DATA_TYPE_ACK_DATA_2 0x09
#define DONGLE_UPLOAD_DATA_TYPE_DATA_3 0x0a
#define DONGLE_UPLOAD_DATA_TYPE_ACK_DATA_3 0x0b
#define DONGLE_UPLOAD_DATA_TYPE_DATA_4 0x0c
#define DONGLE_UPLOAD_DATA_TYPE_ACK_DATA_4 0x0d

typedef union
{
    uint8_t flags;
    struct
    {
        uint8_t _;
        uint8_t val[sizeof(dongle_otp_val)];
    } otp;
    struct
    {
        uint8_t _;
        uint8_t val[sizeof(enctr_entry_counter_t)];
    } num_recs;
    struct
    {
        uint8_t _;
        uint8_t bytes[19];
    } data;
} interact_state;

int access_advertise();
void peer_update();
void interact_update();
dongle_storage *get_dongle_storage();

#endif
```

## src/button.h
```c
#ifndef __DONGLE_BUTTON_H__
#define __DONGLE_BUTTON_H__

#if DONGLE_BUTTON_RESET

#include "sl_simple_button_instances.h"
#include "sl_bluetooth.h"

#include "dongle.h"
#include "nvm3_lib.h"
#include "stats.h"
#include "common/src/util/log.h"

#define BUTTON_DELAY_SHORT_MS  1000
extern const sl_button_t sl_button_btn0;
extern dongle_config_t config;
extern dongle_stats_t *stats;
extern dongle_epoch_counter_t epoch; // current epoch
extern dongle_timer_t dongle_time; // main dongle timer
extern enctr_list_t *enctr_list;
extern enctr_bitmap_t enctr_bmap;
extern size_t cur_id_idx;
extern uint16_t prev_sync_handle;


/*
 * index 0 - SL_SIMPLE_BUTTON_RELEASED
 * index 1 - SL_SIMPLE_BUTTON_PRESSED
 * index 2 - SL_SIMPLE_BUTTON_DISABLED (unused)
 */
float button_time[3] = { 0.0, 0.0 };

/**************************************************************************//**
 * Simple Button
 * Button state changed callback
 * @param[in] handle
 *    Button event handle
 *****************************************************************************/
void sl_button_on_change(const sl_button_t *handle)
{
#if (DONGLE_BUTTON_RESET == 0)
  return;
#endif

  sl_button_state_t state = sl_button_get_state(handle);
  button_time[state] = now();

  /*
   * ignore button press on other buttons
   */
  if (&sl_button_btn0 != handle)
    return;

  log_expf("button state: %d ts: %.0f\r\n", state, button_time[state]);
  /*
   * we only need the timestamp for button press
   */
  if (state > SL_SIMPLE_BUTTON_RELEASED)
    return;

  float button_delay = button_time[SL_SIMPLE_BUTTON_RELEASED] - button_time[SL_SIMPLE_BUTTON_PRESSED];
  button_time[SL_SIMPLE_BUTTON_RELEASED] = button_time[SL_SIMPLE_BUTTON_PRESSED] = 0;
  log_expf("button delay: %.0f\r\n", button_delay);

  // should not happen ideally
  if (button_delay < 0)
    return;

  // on a short button press, only reset log
  config.en_head = 0;
  config.en_tail = 0;

  // on a long button press, additionally reset clock, stats, and ongoing scans
  if (button_delay > (float) BUTTON_DELAY_SHORT_MS) {
    dongle_time = config.t_cur = config.t_init;
    cur_id_idx = epoch = 0;
    prev_sync_handle = -1;
    memset(enctr_list, 0, sizeof(enctr_list_t) * DONGLE_MAX_BC_TRACKED);

    dongle_reset_bitmap_all(&enctr_bmap);
    nvm3_save_enctr_bmap(&enctr_bmap);

    dongle_stats_reset();
    nvm3_save_stat(stats);
    dongle_download_init();
  }

  nvm3_save_config(&config);
  dongle_info();

  log_expf("==== UPLOAD LOG START [%u:%u] ===\r\n",
      config.en_tail, config.en_head);
  dongle_storage_load_encounter(config.en_tail,
      num_encounters_current(config.en_head, config.en_tail),
      dongle_print_encounter, 0);
  log_expf("%s", "==== UPLOAD LOG END ====\r\n");

  nvm3_load_stat(stats);
  dongle_encounter_report(&config, stats);
  dongle_stats(stats);
}

static inline void configure_button(void)
{
//  simple_button_init();
//  sl_simple_button_init_instances();
  int ret = sl_button_init(&sl_button_btn0);
  sl_button_enable(&sl_button_btn0);
  int ret2 = sl_button_get_state(&sl_button_btn0);
  log_expf("button init ret: %d state: %d\r\n", ret, ret2);
}
#endif /* DONGLE_BUTTON_RESET */

#endif /* __DONGLE_BUTTON_H__ */
```

## src/crypto.c
```c
#include <stdio.h>
#include <stdlib.h>
#include <stdint.h>
#include <string.h>
#include <unistd.h>

#include "crypto.h"
#include "dongle.h"
#include "common/src/util/log.h"

static size_t test_offset;
int ctr_drbg_self_test_entropy( void *data, unsigned char *buf,
                                       size_t len )
{
    const unsigned char *p = data;
    memcpy( buf, p + test_offset, len );
    test_offset += len;
    return( 0 );
}


void run_mbedtls_benchmark(void)
{
#if 0
  float startts = 0.0, endts = 0.0;
  uint64_t starttick = 0, endtick = 0;

  int mt_ret2 = 0, mt_cnt = 20;
  char *rand256 = malloc(1024);
  memset(rand256, 0, 1024);


  static const unsigned char entropy_source_nopr[] =
      { 0x4c, 0xfb, 0x21, 0x86, 0x73, 0x34, 0x6d, 0x9d,
        0x50, 0xc9, 0x22, 0xe4, 0x9b, 0x0d, 0xfc, 0xd0,
        0x90, 0xad, 0xf0, 0x4f, 0x5c, 0x3b, 0xa4, 0x73,
        0x27, 0xdf, 0xcd, 0x6f, 0xa6, 0x3a, 0x78, 0x5c,
        0x01, 0x69, 0x62, 0xa7, 0xfd, 0x27, 0x87, 0xa2,
        0x4b, 0xf6, 0xbe, 0x47, 0xef, 0x37, 0x83, 0xf1,
        0xb7, 0xec, 0x46, 0x07, 0x23, 0x63, 0x83, 0x4a,
        0x1b, 0x01, 0x33, 0xf2, 0xc2, 0x38, 0x91, 0xdb,
        0x4f, 0x11, 0xa6, 0x86, 0x51, 0xf2, 0x3e, 0x3a,
        0x8b, 0x1f, 0xdc, 0x03, 0xb1, 0x92, 0xc7, 0xe7 };

  static const unsigned char pers_nopr[] =
      { 0x88, 0xee, 0xb8, 0xe0, 0xe8, 0x3b, 0xf3, 0x29,
        0x4b, 0xda, 0xcd, 0x60, 0x99, 0xeb, 0xe4, 0xbf,
        0x55, 0xec, 0xd9, 0x11, 0x3f, 0x71, 0xe5, 0xeb,
        0xcb, 0x45, 0x75, 0xf3, 0xd6, 0xa6, 0x8a, 0x6b };


  struct mbedtls_ctr_drbg_context mtc;
  mbedtls_ctr_drbg_init(&mtc);
  mbedtls_ctr_drbg_set_entropy_len( &mtc, MBEDTLS_CTR_DRBG_KEYSIZE);
  mbedtls_ctr_drbg_set_nonce_len( &mtc, MBEDTLS_CTR_DRBG_KEYSIZE / 2 );
  mbedtls_ctr_drbg_seed(&mtc,
                        ctr_drbg_self_test_entropy,
                        (void *) entropy_source_nopr,
                        pers_nopr, MBEDTLS_CTR_DRBG_KEYSIZE);
//  mbedtls_ctr_drbg_set_prediction_resistance( &mtc, MBEDTLS_CTR_DRBG_PR_ON );
  mbedtls_ctr_drbg_reseed( &mtc, NULL, 0 );
//  int mt_ret = mbedtls_ctr_drbg_self_test(0);
//  log_infof("mt_ret: %d random init\r\n", mt_ret);

  float ts32 = 0.0, sum_ts32 = 0.0, max_ts32 = 0.0, min_ts32 = 999.9;
  uint32_t tick32 = 0, sum_tick32 = 0, min_tick32 = 999, max_tick32 = 0;
  uint32_t rand32 = 0;
  for (int tmp = 0; tmp < mt_cnt; tmp++) {
    starttick = sl_sleeptimer_get_tick_count64();
    startts = now();
    mt_ret2 = mbedtls_ctr_drbg_random(&mtc, (unsigned char *) &rand32, sizeof(uint32_t));
    endts = now();
    endtick = sl_sleeptimer_get_tick_count64();
    ts32 = endts - startts;
    tick32 = endtick - starttick;
    if (max_ts32 < ts32)
      max_ts32 = ts32;
    if (min_ts32 > ts32)
      min_ts32 = ts32;

    if (max_tick32 < tick32)
      max_tick32 = tick32;
    if (min_tick32 > tick32)
      min_tick32 = tick32;

    sum_ts32 += ts32;
    sum_tick32 += tick32;
    log_infof("sz: %u, val: %u, time: %f ms, tick: %u\r\n", sizeof(uint32_t), rand32, ts32, tick32);
  }
  log_infof("random time avg: %f ms, min: %f ms, max: %f ms\r\n",
    (sum_ts32/mt_cnt), min_ts32, max_ts32);

  log_infof("random tick avg: %f, min: %u ms, max: %u ms\r\n",
    ((float) sum_tick32/mt_cnt), min_tick32, max_tick32);

  startts = 0.0; endts = 0.0;
  float ts256 = 0.0, sum_ts256 = 0.0, max_ts256 = 0.0, min_ts256 = 999.9;
  starttick = 0, endtick = 0;
  uint32_t tick256 = 0, sum_tick256 = 0, min_tick256 = 999, max_tick256 = 0;
  mt_ret2 += 1; mt_cnt = 20;
  char *rand256 = malloc(1024);
  memset(rand256, 0, 1024);
  for (int tmp = 0; tmp < mt_cnt; tmp++) {
    starttick = sl_sleeptimer_get_tick_count64();
    startts = now();
    mt_ret2 = mbedtls_ctr_drbg_random(&mtc, (unsigned char *) rand256, 1024);
    endts = now();
    endtick = sl_sleeptimer_get_tick_count64();
    ts256 = endts - startts;
    tick256 = endtick - starttick;
    if (max_ts256 < ts256)
      max_ts256 = ts256;
    if (min_ts256 > ts256)
      min_ts256 = ts256;

    if (max_tick256 < tick256)
      max_tick256 = tick256;
    if (min_tick256 > tick256)
      min_tick256 = tick256;

    sum_ts256 += ts256;
    sum_tick256 += tick256;
    log_infof("sz: %u, v[0]: %u, v[1]: %u, time: %f ms, tick: %u\r\n",
      1024, ((uint32_t *) rand256)[0], ((uint32_t *) rand256)[1], ts256, tick256);
  }

  log_infof("random time avg: %f ms, min: %f ms, max: %f ms\r\n",
    (sum_ts256/mt_cnt), min_ts256, max_ts256);

  log_infof("random tick avg: %f, min: %u ms, max: %u ms\r\n",
    ((float) sum_tick256/mt_cnt), min_tick256, max_tick256);

  // ========

  free(rand256);
#endif
}

void run_psa_benchmark(void)
{
  float startts = 0.0, endts = 0.0;
  uint64_t starttick = 0, endtick = 0;
  int mt_ret2 = 0, mt_cnt = 20;
  float ts256 = 0.0, sum_ts256 = 0.0, max_ts256 = 0.0, min_ts256 = 999.9;
  starttick = 0, endtick = 0;
  uint32_t tick256 = 0, sum_tick256 = 0, min_tick256 = 999, max_tick256 = 0;
  char *rand256 = malloc(1024);
  memset(rand256, 0, 1024);

  log_infof("Init PSA crypto ret: %d\r\n", mt_ret2);

  mt_ret2 = psa_crypto_init();
  startts = 0.0; endts = 0.0;
  ts256 = 0.0, sum_ts256 = 0.0, max_ts256 = 0.0, min_ts256 = 999.9;
  starttick = 0, endtick = 0;
  tick256 = 0, sum_tick256 = 0, min_tick256 = 999, max_tick256 = 0;
  mt_ret2 += 1; mt_cnt = 20;

  for (int tmp = 0; tmp < mt_cnt; tmp++) {
    starttick = sl_sleeptimer_get_tick_count64();
    startts = now();
    mt_ret2 = psa_generate_random((uint8_t *) rand256, 1024);
    endts = now();
    endtick = sl_sleeptimer_get_tick_count64();
    ts256 = endts - startts;
    tick256 = endtick - starttick;
    if (max_ts256 < ts256)
      max_ts256 = ts256;
    if (min_ts256 > ts256)
      min_ts256 = ts256;

    if (max_tick256 < tick256)
      max_tick256 = tick256;
    if (min_tick256 > tick256)
      min_tick256 = tick256;

    sum_ts256 += ts256;
    sum_tick256 += tick256;
    log_infof("sz: %u, v[0]: %u, v[1]: %u, time: %f ms, tick: %u\r\n",
      1024, ((uint32_t *) rand256)[0], ((uint32_t *) rand256)[1], ts256, tick256);
  }

  log_infof("random time avg: %f ms, min: %f ms, max: %f ms\r\n",
    (sum_ts256/mt_cnt), min_ts256, max_ts256);

  log_infof("random tick avg: %f, min: %u ms, max: %u ms\r\n",
    ((float) sum_tick256/mt_cnt), min_tick256, max_tick256);

  mbedtls_psa_crypto_free();

  // ========

  free(rand256);
}
```

## src/crypto.h
```c
#ifndef __CRYPTO_H__
#define __CRYPTO_H__

#include "sx_trng.h"
#include <mbedtls/ctr_drbg.h>
#include <mbedtls/psa_util.h>
// #include <mbedtls/sl_crypto/include/trng.h>

extern void run_mbedtls_benchmark(void);
extern void run_psa_benchmark(void);

#endif /* __CRYPTO_H__ */
```

## src/dongle.c
```c
//
// Dongle Application for PanCast Beacon logging
// Early version based on the bluetooth-central example from Zephyr
// This acts as a passive scanner that makes no connections and
// instead interprets and logs payload data from PanCast beacons.
//

#include "dongle.h"

#include <string.h>

#include "app_assert.h"
#include "app_log.h"

#include "stats.h"
#include "storage.h"
#include "test.h"
#include "upload.h"
#include "encounter.h"
#include "telemetry.h"
#include "download.h"
#include "led.h"
#include "button.h"
#include "nvm3_lib.h"

#include "common/src/util/log.h"
#include "common/src/constants.h"
#include "common/src/test.h"
#include "common/src/util/util.h"
#include "crypto.h"

// in-memory config
dongle_config_t config;

sl_sleeptimer_timer_handle_t led_timer;
int led_state = 0;
dongle_epoch_counter_t epoch; // current epoch
dongle_timer_t dongle_time; // main dongle timer
enctr_list_t *enctr_list;
enctr_bitmap_t enctr_bmap;
dongle_stats_t *stats;
size_t cur_id_idx;
extern download_t *download;

// 5. Statistics and Telemetry
// Global high-precision timer, in milliseconds
float dongle_hp_timer = 0.0;

static void dongle_config_init(dongle_config_t *cfg,
    enctr_list_t **enctr_list_p, enctr_bitmap_t *enctr_bmap,
    dongle_stats_t **stats_p, download_t **download_p)
{
  if (!cfg)
    return;

  cfg->backend_pk = malloc(PK_MAX_SIZE);
  memset(cfg->backend_pk, 0, PK_MAX_SIZE);

  cfg->dongle_sk = malloc(SK_MAX_SIZE);
  memset(cfg->dongle_sk, 0, SK_MAX_SIZE);

  if (enctr_list_p) {
    enctr_list_t *enctr_list = malloc(DONGLE_MAX_BC_TRACKED *
        sizeof(enctr_list_t));
    memset(enctr_list, 0, DONGLE_MAX_BC_TRACKED * sizeof(enctr_list_t));
    *enctr_list_p = enctr_list;
  }

  if (enctr_bmap) {
    dongle_init_bitmap(enctr_bmap);
  }

  if (stats_p) {
    dongle_stats_t *tmp_stats = malloc(sizeof(dongle_stats_t));
    memset(tmp_stats, 0, sizeof(dongle_stats_t));
    *stats_p = tmp_stats;
  }

  if (download_p) {
    download_t *download = malloc(sizeof(download_t));
    dongle_download_init();
    *download_p = download;
  }
}

void dongle_cleanup_config(dongle_config_t *cfg)
{
  if (!cfg)
    return;

  if (cfg->backend_pk)
    free(cfg->backend_pk);

  if (cfg->dongle_sk)
    free(cfg->dongle_sk);
}

/*
 * invoke after kernel has initialized and bluetooth device is booted.
 * load config from flash and nvm3, init or reset variables and init scan
 */
void dongle_init()
{
  dongle_config_t sto_cfg;
  dongle_stats_t sto_stats;

  // init flash storage
  dongle_storage_init();

//  // reset downloaded space
//  dongle_download_init();

  // init configs
  dongle_config_init(&sto_cfg, NULL, NULL, NULL, NULL);
  dongle_config_init(&config, &enctr_list, &enctr_bmap, &stats, &download);

  // load config
  dongle_storage_load_config(&sto_cfg);
  nvm3_load_config(&config);
  nvm3_load_enctr_bmap(&enctr_bmap);
  dongle_print_bitmap_all(&enctr_bmap);
//  nvm3_save_enctr_bmap(&enctr_bmap);
//  nvm3_load_enctr_bmap(&enctr_bmap);

  config.id = sto_cfg.id;
  config.t_init = sto_cfg.t_init;
  config.backend_pk_size = sto_cfg.backend_pk_size;
  config.dongle_sk_size = sto_cfg.dongle_sk_size;
  memcpy(config.backend_pk, sto_cfg.backend_pk, sto_cfg.backend_pk_size);
  memcpy(config.dongle_sk, sto_cfg.dongle_sk, sto_cfg.dongle_sk_size);

  // load stats
  dongle_storage_read_stat(&sto_stats, sizeof(dongle_stats_t));
  nvm3_load_stat(stats);

  log_expf("=== [C, H, T] nvm: %u %u %u sto: %u %u %u csum: 0x%0x ===\r\n",
      config.t_cur, config.en_head, config.en_tail, sto_cfg.t_cur,
      sto_cfg.en_head, sto_cfg.en_tail, sto_stats.storage_checksum);

  // reset nvm3 state and stats if checksum on dongle flash does not match
  // we reset checksum when flashing image through config scripts
  if (sto_stats.storage_checksum != DONGLE_STORAGE_STAT_CHKSUM) {
    sto_stats.storage_checksum = DONGLE_STORAGE_STAT_CHKSUM;
    dongle_storage_save_stat(&sto_cfg, &sto_stats, sizeof(dongle_stats_t));

//    config.t_cur = config.en_head = config.en_tail = 0;
    config.t_cur = sto_cfg.t_cur;
    config.en_head = sto_cfg.en_head;
    config.en_tail = sto_cfg.en_tail;
    nvm3_save_config(&config);

    // intent to reset everything
    if (sto_cfg.en_head == 0 && sto_cfg.en_tail == 0) {
      dongle_reset_bitmap_all(&enctr_bmap);
      nvm3_save_enctr_bmap(&enctr_bmap);
    }

    dongle_stats_reset(stats);
    nvm3_save_stat(stats);
  }

//  dongle_load();

  // set dongle time to current saved time
  dongle_time = config.t_cur > config.t_init ? config.t_cur : config.t_init;
  cur_id_idx = 0;
  epoch = 0;

  // print basic device info and state
  dongle_info();
  dongle_encounter_report(&config, stats);
  dongle_stats(stats);

  // update last report time and save to nvm3
  stats->stat_ints.last_report_time = dongle_time;
  nvm3_save_stat(stats);

#if TEST_DONGLE
  // test
  dongle_test_enctr_storage();

  config.en_tail = 0;
  config.en_head = MAX_LOG_COUNT-1;
#endif

  log_expf("==== UPLOAD LOG START [%u:%u] ===\r\n",
      config.en_tail, config.en_head);
  dongle_storage_load_encounter(0, MAX_LOG_COUNT,
      dongle_print_encounter, 0);
//  dongle_storage_load_encounter(config.en_tail,
//      num_encounters_current(config.en_head, config.en_tail),
//      dongle_print_encounter, 0);
  log_expf("%s", "==== UPLOAD LOG END ====\r\n");

//  dongle_reset_bitmap_all(&enctr_bmap);

  //===========

//  // reset stats
//  dongle_stats_init();

  // set up LED
  configure_blinky();

#if DONGLE_BUTTON_RESET
  configure_button();
#endif

#if DONGLE_CRYPTO
  // run crypto benchmark
  run_mbedtls_benchmark();
  run_psa_benchmark();
#endif

  dongle_cleanup_config(&sto_cfg);

  // initialize periodic advertisement scanning
  dongle_init_scan();
}

/* START
   Start scan
 */
void dongle_start_scan()
{
  sl_status_t sc = sl_bt_scanner_start(SCAN_PHY, SCAN_DISCOVER_MODE);
  log_infof("=== Starting Dongle: 0x%0x... ===\r\n", sc);
  if (sc != SL_STATUS_OK) {
    log_errorf("error starting scan, sc: 0x%x\r\n", sc);
  }
}

void dongle_stop_scan()
{
  sl_status_t sc = sl_bt_scanner_stop();
  log_infof("=== Stopping Dongle: 0x%0x... ===\r\n", sc);
  if (sc != SL_STATUS_OK) {
    log_errorf("error stopping scan, sc: 0x%x\r\n", sc);
  }
}

void dongle_init_scan()
{
  sl_status_t sc = 0;

  sc = sl_bt_scanner_set_timing(SCAN_PHY, SCAN_INTERVAL, SCAN_WINDOW);
  if (sc != SL_STATUS_OK) {
    log_errorf("error setting scanner timing, sc: 0x%x\r\n", sc);
  }

  sc = sl_bt_scanner_set_mode(SCAN_PHY, SCAN_MODE);
  if (sc != SL_STATUS_OK) {
    log_errorf("error setting scanner mode, sc: 0x%x\r\n", sc);
  }

  sc = sl_bt_sync_set_parameters(SYNC_SKIP, SYNC_TIMEOUT, SYNC_FLAGS);
  if (sc != SL_STATUS_OK) {
    log_errorf("error setting sync params, sc: 0x%x\r\n", sc);
  }
}

#if 0
/*
 * Load state and configuration from flash
 */
void dongle_load()
{
  dongle_config_init(&config);
  dongle_storage_init();
  // Config load is required to properly set up the memory maps
  dongle_storage_load_config(&config);
  enctr_entry_counter_t sto_en_head = config.en_head;
  enctr_entry_counter_t sto_en_tail = config.en_tail;
  dongle_timer_t sto_t_cur = config.t_cur;

  nvm3_load_config(&config);

#if 0
  if (sto_en_head == 0)
    config.en_head = 0;

  if (sto_en_tail == 0)
    config.en_tail = 0;

  if (sto_t_cur == 0)
    config.t_cur = 0;
#endif

  // if device re-flashed, all these fields would be zero, reset in the NVM too
  if (sto_en_head == 0 || sto_en_tail == 0 || sto_t_cur == 0)
    nvm3_save_clock_cursor(&config);
}
#endif

void dongle_clock_increment()
{
  dongle_time++;
  dongle_on_clock_update();
}

void dongle_hp_timer_add(uint32_t ticks)
{
  double ms = ((double) ticks * PREC_TIMER_TICK_MS);
  stats->stat_ints.total_periodic_data_time += (ms / 1000.0);
  if (download->is_active) {
    download->time += ms;
  }
  dongle_hp_timer += ms;
}

// UPDATE
// For callback-based timers. This is called with the mutex
// locked whenever the application clock obtains a new value.
void dongle_on_clock_update()
{
  // update epoch
  dongle_epoch_counter_t new_epoch = epoch_i(dongle_time, config.t_init);
  if (new_epoch != epoch) {
    epoch = new_epoch;
  }
  // update dongle time in config and save to flash
  config.t_cur = dongle_time;
//  dongle_storage_save_config(&config);
  nvm3_save_clock_cursor(&config);
  dongle_save_encounters();
  dongle_report();
}

/* Log system counters */
void dongle_log_counters()
{
  uint16_t    tx_packets;
  uint16_t    rx_packets;
  uint16_t    crc_errors;
  uint16_t    failures;

  sl_bt_system_get_counters(1, &tx_packets, &rx_packets, &crc_errors, &failures);

  stats->stat_ints.total_hw_rx += (uint32_t) rx_packets;
  stats->stat_ints.total_hw_crc_fail += (uint32_t)crc_errors;

//  log_debugf("tx_packets: %lu, rx_packets: %lu, crc_errors: %lu, failures: %lu\r\n",
//      tx_packets, rx_packets, crc_errors, failures);
}

void dongle_reset_counters()
{
  sl_bt_system_get_counters(1, 0, 0, 0, 0);
}

static int
decode_payload(uint8_t *data)
{
  data[0] = data[1];
  data[1] = data[MAX_BROADCAST_SIZE - 1];
  return 0;
}

// matches the schema defined by encode
static int decode_encounter(encounter_broadcast_t *dat,
                            encounter_broadcast_raw_t *raw)
{
  uint8_t *src = (uint8_t *)raw;
  size_t pos = 0;
#define link(dst, type)          \
  (dst = (type *)(src + pos)); \
  pos += sizeof(type)

  link(dat->t, beacon_timer_t);
  link(dat->b, beacon_id_t);
  link(dat->loc, beacon_location_id_t);
  link(dat->eph, beacon_eph_id_t);
#undef link
  return 0;
}

/* Same functionality as _dongle_encounter_ but takes duration into account
 */
static void dongle_save_encounter(mem_encounter_entry_t *enc, size_t i)
{
#if 0
  hexdumpen(enc->eph_id.bytes, BEACON_EPH_ID_HASH_LEN, "log enc",
    enc->beacon_id, (uint32_t) enc->location_id, (uint16_t) i,
    (uint32_t) enc->beacon_time_start, enc->beacon_time_int,
    (uint32_t) enc->dongle_time_start, enc->dongle_time_int,
    (int8_t) enc->rssi, (uint32_t) ENCOUNTER_LOG_OFFSET(i));
#endif

  dongle_encounter_entry_t de;
//  memset(&de, 0, sizeof(dongle_encounter_entry_t));
  de.location_id = enc->location_id;
  de.beacon_id = enc->beacon_id;
  de.beacon_time_start = enc->beacon_time_start;
  de.dongle_time_start = enc->dongle_time_start;
  de.beacon_time_int = enc->beacon_time_int;
  de.dongle_time_int = enc->dongle_time_int;
  de.rssi = (int8_t) enc->rssi;
  memcpy(&de.eph_id, &enc->eph_id, sizeof(beacon_eph_id_t));
  dongle_storage_log_encounter(&config, &dongle_time, &de);
  memset(&enctr_list[i], 0, sizeof(enctr_list_t));
}

static void dongle_track(encounter_broadcast_t *enc, int8_t rssi)
{
  // Check the broadcast UUID
  beacon_id_t service_id = (*(enc->b) & BEACON_SERVICE_ID_MASK) >> 16;
  if (service_id != BROADCAST_SERVICE_ID) {
    return;
  }

#if MODE__STAT
  stat_add(rssi, stats->stat_grp.scan_rssi);
#endif

  // determine which tracked id, if any, is a match
  int found = 0, i;
  for (i = 0; i < (int) DONGLE_MAX_BC_TRACKED; i++) {
    if (!compare_eph_id(enc->eph, &enctr_list[i].e.eph_id)) {
      found = 1;
      break;
    }
  }

  if (found == 0) {
    // if no match was found, start tracking the new id, replacing the oldest
    // one currently tracked
    i = cur_id_idx;
//    print_bytes(enc->eph->bytes, BEACON_EPH_ID_HASH_LEN, "new ID");
    cur_id_idx = (cur_id_idx + 1) % DONGLE_MAX_BC_TRACKED;

    // copy eph id bytes into tracking array
    memcpy(&enctr_list[i].e.eph_id, enc->eph->bytes, BEACON_EPH_ID_HASH_LEN);
    enctr_list[i].e.beacon_id = *(enc->b);
    memcpy(&(enctr_list[i].e.location_id), enc->loc, sizeof(beacon_location_id_t));
//    enctr_list[i].e.location_id = *(enc->loc);
    enctr_list[i].e.beacon_time_start = *(enc->t);
    enctr_list[i].e.dongle_time_start = dongle_time;
    enctr_list[i].e.dongle_time_int = 0;
    /*
     * conservatively assume that the first instance of an encounter
     * is observed at the beginning of the timer interval.
     */
    enctr_list[i].e.beacon_time_int = 1;
    enctr_list[i].e.rssi = rssi;

#if 1
    beacon_eph_id_t *id = &enctr_list[i].e.eph_id;
    hexdumpen(id, BEACON_EPH_ID_HASH_LEN, "new enc",
      enctr_list[i].e.beacon_id,
      (uint32_t) enctr_list[i].e.location_id, (uint16_t) i,
      (uint32_t) enctr_list[i].e.beacon_time_start,
      enctr_list[i].e.beacon_time_int,
      (uint32_t) enctr_list[i].e.dongle_time_start,
      enctr_list[i].e.dongle_time_int,
      (int8_t) enctr_list[i].e.rssi, (uint32_t) ENCOUNTER_LOG_OFFSET(i));
#endif

#if MODE__STAT
    stat_add(rssi, stats->stat_grp.enctr_rssi);
#endif

    return;
  }

  uint8_t dongle_dur = (uint8_t) (dongle_time - enctr_list[i].e.dongle_time_start);
  uint8_t beacon_dur = (uint8_t) (*enc->t - enctr_list[i].e.beacon_time_start + 1);

  enctr_list[i].e.dongle_time_int = dongle_dur;
  enctr_list[i].e.beacon_time_int = beacon_dur;
  enctr_list[i].e.rssi = ((enctr_list[i].e.rssi*enctr_list[i].n) + rssi) /
    (enctr_list[i].n+1);
  enctr_list[i].n += 1;

  return;
}

void dongle_save_encounters()
{
  for (int i = 0; i < DONGLE_MAX_BC_TRACKED; i++) {
//    dongle_timer_t end_time = enctr_list[i].e.dongle_time_start
//      + enctr_list[i].e.dongle_time_int;

#if 0
   beacon_eph_id_t *id = &enctr_list[i].e.eph_id;
   hexdumpen(id, BEACON_EPH_ID_HASH_LEN, "chk enc",
     enctr_list[i].e.beacon_id,
     (uint32_t) enctr_list[i].e.location_id, (uint16_t) i,
     (uint32_t) enctr_list[i].e.beacon_time_start,
     enctr_list[i].e.beacon_time_int,
     (uint32_t) enctr_list[i].e.dongle_time_start,
     enctr_list[i].e.dongle_time_int,
     (int8_t) enctr_list[i].e.rssi, (uint32_t) ENCOUNTER_LOG_OFFSET(i));
#endif

    /*
     * if one epoch has passed and we haven't seen the eph id again,
     * then count this as the end of the duration and log the encounter
     */
    if (enctr_list[i].e.dongle_time_start != 0 &&
        dongle_time - enctr_list[i].e.dongle_time_start > LOG_MIN_WAIT) {
      dongle_save_encounter(&enctr_list[i].e, i);
    }
  }
}

void dongle_on_scan_report(bd_addr *addr __attribute__((unused)), int8_t rssi,
    uint8_t *data, uint8_t data_len)
{
  // Filter mis-sized packets
  if (data_len != ENCOUNTER_BROADCAST_SIZE + 1) {
    // TODO: should check for a periodic packet identifier
    return;
  }

  decode_payload(data);
  encounter_broadcast_t en;
  decode_encounter(&en, (encounter_broadcast_raw_t *)data);
  dongle_track(&en, rssi);
}

// used as callback for dongle_load_encounter
int dongle_print_encounter(enctr_entry_counter_t i,
    dongle_encounter_entry_t *entry,
    uint32_t num_buckets __attribute__((unused)))
{
  beacon_eph_id_t *id = &entry->eph_id;

  char dbuf[8];
  memset(dbuf, 0, 8);

  int byte_idx = ENCOUNTER_BYTE_IDX(i);
  int byte_off = ENCOUNTER_BYTE_OFF(i);

  int match_status = enctr_bmap.match_status[byte_idx] & (1 << byte_off);
  if (match_status == 0)
    sprintf(dbuf, "read 0");
  else
    sprintf(dbuf, "read 1");

  hexdumpen(id, BEACON_EPH_ID_HASH_LEN, dbuf, entry->beacon_id,
    (uint32_t) entry->location_id, (uint16_t) i,
    (uint32_t) entry->beacon_time_start, entry->beacon_time_int,
    (uint32_t) entry->dongle_time_start, entry->dongle_time_int,
    (int8_t) entry->rssi, (uint32_t) ENCOUNTER_LOG_OFFSET(i));

  return 1;
}

void dongle_info()
{
  log_expf("%s", "=== Dongle Info: ===\r\n");
  log_expf("   Dongle ID:                        0x%x\r\n", config.id);
  log_expf("   Clock init, cur, dongle_time:     %lu, %lu, %lu\r\n",
    config.t_init, config.t_cur, dongle_time);
  log_expf("   Timer frequency:                  %u Hz\r\n",
    sl_sleeptimer_get_timer_frequency());
  log_expf("   Backend public key size:          %lu bytes\r\n",
    config.backend_pk_size);
  log_expf("   Secret key size:                  %lu bytes\r\n",
    config.dongle_sk_size);
  log_expf("   Timer resolution:                 %u ms\r\n",
    DONGLE_TIMER_RESOLUTION);
  log_expf("   Epoch length:                     %.1f min\r\n",
    ((float) BEACON_EPOCH_LENGTH * DONGLE_TIMER_RESOLUTION)/60000);
  log_expf("   Report interval:                  %u min\r\n",
    (DONGLE_REPORT_INTERVAL * DONGLE_TIMER_RESOLUTION)/60000);
  log_expf("   Legacy adv scan [PHY, mode]:      %d, %d\r\n",
    SCAN_PHY, SCAN_MODE);
  log_expf("   Legacy adv scan intvl, wnd, cycle:%.02f ms, %.02f ms, %u ms\r\n",
    SCAN_INTERVAL*0.625, SCAN_WINDOW*0.625,
    SCAN_CYCLE_TIME * DONGLE_TIMER_RESOLUTION);
  log_expf("   Periodic adv sync skip, flags:    %d, %d\r\n",
    SYNC_SKIP, SYNC_FLAGS);
  log_expf("   Periodic adv sync timeout:        %u ms\r\n",
    SYNC_TIMEOUT*10);
  log_expf("   Periodic adv sync fail:           %.1f min\r\n",
    ((float) PERIODIC_SYNC_FAIL_LATENCY * DONGLE_TIMER_RESOLUTION)/60000);
  log_expf("   Periodic adv download lat:        %u min\r\n",
    (DOWNLOAD_LATENCY_THRESHOLD * DONGLE_TIMER_RESOLUTION)/60000);
  log_expf("   Periodic adv retry, new interval: %u min, %u min\r\n",
    (RETRY_DOWNLOAD_INTERVAL * DONGLE_TIMER_RESOLUTION)/60000,
    (NEW_DOWNLOAD_INTERVAL * DONGLE_TIMER_RESOLUTION)/60000);

  log_expf("   Flash page size, count, total:    %u B, %u, %u B\r\n",
    FLASH_DEVICE_PAGE_SIZE, FLASH_DEVICE_NUM_PAGES,
    (FLASH_DEVICE_NUM_PAGES * FLASH_DEVICE_PAGE_SIZE));
  log_expf("   Flash offset:                     0x%0x\r\n", FLASH_OFFSET);
  log_expf("   Log range, size:                  0x%0x-0x%0x, %u\r\n",
    ENCOUNTER_LOG_START, ENCOUNTER_LOG_END,
    (ENCOUNTER_LOG_END - ENCOUNTER_LOG_START));
  log_expf("   Encounter size (storage, mem):    %u, %u\r\n",
    sizeof(dongle_encounter_entry_t), sizeof(mem_encounter_entry_t));
  log_expf("   Max enctr entries:                %lu\r\n", MAX_LOG_COUNT);
  log_expf("   Log head, tail:                   %u, %u\r\n",
    config.en_head, config.en_tail);
  log_expf("   Config offset:                    0x%0x\r\n",
    DONGLE_CONFIG_OFFSET);
  log_expf("   OTP offset, stat offset:          0x%0x, 0x%0x\r\n",
    DONGLE_OTPSTORE_OFFSET, DONGLE_STATSTORE_OFFSET);
  log_expf("   Stat size, nvm3 size, dwnld size: %u, %u, %u\r\n",
    sizeof(dongle_stats_t), NVM3_DEFAULT_MAX_OBJECT_SIZE,
    sizeof(download_t));
  log_expf("   NVM3 #bitmap keys, #logs/bitmap:  %u, %u\r\n",
      NUM_NVM3_BITMAP_KEYS, NUM_LOG_ENTRIES_PER_NVM3_BITMAP_KEY);
}

void dongle_report()
{
#if MODE__STAT
  // do report
  if (((int) (dongle_time - stats->stat_ints.last_report_time)) <
      (int) DONGLE_REPORT_INTERVAL)
    return;

  dongle_encounter_report(&config, stats);
  dongle_stats(stats);
  stats->stat_ints.last_report_time = dongle_time;
//  dongle_storage_save_stat(&config, stats, sizeof(dongle_stats_t));
  nvm3_save_stat(stats);

#endif
}
```

## src/download.h
```c
#ifndef DONGLE_DOWNLOAD__H
#define DONGLE_DOWNLOAD__H

#include <stdint.h>

#include "common/src/constants.h"
#include "storage.h"

typedef struct {
  int is_active;
  double time;
  uint32_t n_syncs_lost;
  uint32_t n_total_packets;
  uint32_t n_corrupt_packets;
  uint32_t n_matches;
  struct {
    // number of unique packets seen
    int num_distinct;

    // number of bytes received
    uint32_t received;

    // the current chunk being downloaded
    uint32_t cur_chunkid;
    uint32_t numchunks;

#if 0
    // pkt counts before current chunk download repeats
    int8_t chunk_prev_counts[MAX_NUM_PACKETS_PER_FILTER];
    int8_t chunk_complete[MAX_NUM_CHUNKS/BITS_PER_BYTE];
#endif

    // track of seq# recvd in each chunk
    struct {
      // map of sequence number to packet count for that number
      // used to track completion of the download
      int8_t counts[MAX_NUM_PACKETS_PER_FILTER];
    } chunk_arr[MAX_NUM_CHUNKS];

    // actual received payload
    struct {
      uint64_t data_len;
      uint8_t data[CF_SIZE_BYTES];
    } buffer;

  } packet_buffer;
} download_t;

typedef struct enctr_bitmap {
  uint8_t *match_status;
} enctr_bitmap_t;

// Count packet duplication
#define dongle_download_duplication(s, d) \
  do {  \
    for (uint32_t c = 0; c < d->packet_buffer.numchunks; c++) { \
      for (int i = 0; i < (int) MAX_NUM_PACKETS_PER_FILTER; i++) { \
        uint32_t count = d->packet_buffer.chunk_arr[c].counts[i]; \
        if (count > 0) { \
          stat_add(count, s.pkt_duplication); \
        } \
      } \
    } \
  } while (0)

#define dongle_update_download_stats(s, d) \
  do {  \
    stat_add(d->packet_buffer.received, s.n_bytes); \
    stat_add(d->n_syncs_lost, s.syncs_lost); \
    dongle_download_duplication(s, d); \
    float loss_est = dongle_download_estimate_loss(d); \
    stat_add(loss_est, s.est_pkt_loss);  \
  } while (0)

void dongle_download_init();
void dongle_download_info();
void dongle_download_complete();
void dongle_download_fail();

void dongle_on_periodic_data(uint8_t *data, uint8_t data_len, int8_t rssi);
void dongle_on_periodic_data_error(int8_t rssi);
void dongle_on_sync_lost();

int dongle_download_complete_status();

void dongle_init_bitmap(enctr_bitmap_t *enctr_bmap);
void dongle_print_bitmap_all(enctr_bitmap_t *enctr_bmap);
void dongle_reset_bitmap_all(enctr_bitmap_t *enctr_bmap);
void dongle_reset_bitmap_bit_range(enctr_bitmap_t *enctr_bmap,
    uint32_t startbit, uint32_t endbit);
void dongle_set_bitmap_bit(enctr_bitmap_t *enctr_bmap, uint32_t bmap_idx,
    uint32_t bmap_off);
int dongle_has_bitmap_bit_set(enctr_bitmap_t *enctr_bmap);
int dongle_count_bitmap_bit_set(enctr_bitmap_t *enctr_bmap);

#endif
```

## src/encounter.c
```c
#include <stdio.h>
#include <string.h>

#include "encounter.h"
#include "dongle.h"

#include "common/src/util/log.h"
#include "common/src/util/util.h"

// compares two ephemeral ids
int compare_eph_id(beacon_eph_id_t *a, beacon_eph_id_t *b)
{
#define A (a->bytes)
#define B (b->bytes)
  for (int i = 0; i < BEACON_EPH_ID_HASH_LEN; i++) {
    if (A[i] != B[i])
      return 1;
  }
#undef B
#undef A
  return 0;
}

void display_eph_id(beacon_eph_id_t *id)
{
  log_infof("EID: "
"\\x%02x\\x%02x\\x%02x\\x%02x\\x%02x\\x%02x\\x%02x\\x%02x\\x%02x\\x%02x\\x%02x\\x%02x\\x%02x\\x%02x\r\n",
  id->bytes[0], id->bytes[1], id->bytes[2], id->bytes[3], id->bytes[4],
  id->bytes[5], id->bytes[6], id->bytes[7], id->bytes[8], id->bytes[9],
  id->bytes[10], id->bytes[11], id->bytes[12], id->bytes[13]);
}

void _display_encounter_(dongle_encounter_entry_t *entry)
{
  log_infof("%s", "Encounter data:\r\n");
  log_infof(" t_d: %u,", entry->dongle_time_start);
  log_infof(" i_d: %u,", entry->dongle_time_int);
  log_infof(" b: %lu,", entry->beacon_id);
  log_infof(" t_b: %u,", entry->beacon_time_start);
  log_infof(" i_b: %u,", entry->beacon_time_int);
  log_infof(" loc: %llu\r\n", entry->location_id);
  display_eph_id_of(entry);
}

void display_eph_id_of(dongle_encounter_entry_t *entry)
{
  display_eph_id(&entry->eph_id);
}
```

## src/encounter.h
```c
#ifndef DONGLE_ENCOUNTER__H
#define DONGLE_ENCOUNTER__H

// Small utility API around the abstract encounter
// representation. Should be used in testing.

#include "dongle.h"

int compare_eph_id(beacon_eph_id_t *a, beacon_eph_id_t *b);
void _display_encounter_(dongle_encounter_entry *entry);
void display_eph_id_of(dongle_encounter_entry *entry);
void display_eph_id(beacon_eph_id_t *id);

#endif
```

## src/gecko.h
```c
#ifndef DONGLE_GECKO__H
#define DONGLE_GECKO__H
// Some constants for the hardware variant used to drive gecko
// platform. Coded here as they are not accessed via any API.
#define FLASH_DEVICE_BLOCK_SIZE 4
#define FLASH_DEVICE_NUM_PAGES 64
#define FLASH_DEVICE_PAGE_SIZE 8192
#endif
```
